## Kconfig
```kconfig
# SPDX-License-Identifier: MIT

menu "PMSM motor control"

config PMSM_FOC
	bool "PMSM field-oriented control core"
	select FPU if CPU_HAS_FPU
	select FPU_SHARING if CPU_HAS_FPU
	help
	  Portable float32 FOC math core (transforms, SVPWM, PI, observer,
	  PLL). Plain C, no Zephyr dependencies.

	  Enables the hardware FPU where present. FPU sharing is required
	  because the FOC ISR and the motor thread both use float32.

config PMSM_PLANT
	bool "PMSM plant model"
	select PMSM_FOC
	help
	  Surface-PMSM plant with an ideal inverter, integrated in double
	  precision (include/pmsm/plant.h). Plain C, no Zephyr dependencies.
	  Used by the closed-loop simulation and the simulated power stage;
	  not meant for targets.

rsource "drivers/Kconfig"
rsource "subsys/motor/Kconfig"

endmenu
```

## drivers/power_stage/Kconfig
```kconfig
# SPDX-License-Identifier: MIT

menuconfig PMSM_POWER_STAGE
	bool "PMSM power-stage drivers"
	help
	  Power-stage driver class: synchronised three-phase PWM plus
	  current and bus-voltage sampling, one callback per PWM cycle.
	  See include/pmsm/power_stage.h.

if PMSM_POWER_STAGE

module = PMSM_POWER_STAGE
module-str = pmsm_power_stage
source "subsys/logging/Kconfig.template.log_config"

config PMSM_POWER_STAGE_INIT_PRIORITY
	int "Power-stage driver init priority"
	default KERNEL_INIT_PRIORITY_DEVICE
	help
	  Must run before the motor devices that use the power stage.

config PMSM_POWER_STAGE_SIM
	bool "Simulated power stage"
	default y
	depends on DT_HAS_PMSM_SIM_POWER_STAGE_ENABLED
	select PMSM_PLANT
	help
	  Power stage that drives the plant model (lib/plant) instead of
	  hardware, for tests and samples on native_sim. PWM cycles come from
	  a kernel timer, in batches per timer period, or are stepped by the
	  application with power_stage_sim_run().

endif # PMSM_POWER_STAGE
```

## dts/bindings/motor/pmsm,motor.yaml
```yaml
# SPDX-License-Identifier: MIT

description: |
  Sensorless FOC drive of one PMSM on a power stage (include/pmsm/motor.h).

  The motor parameters are the controller's model of the motor; the gains
  are computed from them at build time. Speeds are mechanical rpm, currents
  are peak phase values.

  Example (FIT1036 estimates, 24 V):

    motor0: motor {
      compatible = "pmsm,motor";
      power-stage = <&power_stage>;
      resistance-micro-ohms = <3600000>;
      inductance-nano-henries = <1500000>;
      flux-linkage-micro-webers = <11000>;
      pole-pairs = <11>;
      inertia-nano-kg-m2 = <6000>;
      max-current-milliamps = <1400>;
      start-current-milliamps = <1000>;
      trip-current-milliamps = <3000>;
      vbus-min-millivolts = <10000>;
      vbus-max-millivolts = <30000>;
      max-speed-rpm = <950>;
    };

compatible: "pmsm,motor"

properties:
  power-stage:
    type: phandle
    required: true
    description: The power-stage device that drives this motor.

  resistance-micro-ohms:
    type: int
    required: true
    description: Phase resistance.

  inductance-nano-henries:
    type: int
    required: true
    description: Phase inductance (Ld = Lq).

  flux-linkage-micro-webers:
    type: int
    required: true
    description: Permanent-magnet flux linkage, peak per phase.

  pole-pairs:
    type: int
    required: true

  inertia-nano-kg-m2:
    type: int
    required: true
    description: Rotor plus load inertia; sets the speed-loop gains.

  max-current-milliamps:
    type: int
    required: true
    description: Largest q current the speed loop commands.

  start-current-milliamps:
    type: int
    required: true
    description: Current during align and I/f startup.

  trip-current-milliamps:
    type: int
    required: true
    description: |
      Software over-current trip, any phase. Must exceed max-current and
      start-current; the controller also clamps its reference to it.

  vbus-min-millivolts:
    type: int
    required: true
    description: Under-voltage trip while the outputs are on.

  vbus-max-millivolts:
    type: int
    required: true
    description: Over-voltage trip while the outputs are on.

  max-speed-rpm:
    type: int
    required: true
    description: |
      Largest target speed. At most the voltage-limited top speed,
      vbus / (sqrt(3) * pole-pairs * flux) rad/s.

  handover-speed-rpm:
    type: int
    default: 290
    description: |
      Switch from I/f to the observer; also the lowest running speed. Must
      be well above the speed where the back-EMF equals R * start-current
      (see docs/PLAN.md, insights M3.2).

  align-time-ms:
    type: int
    default: 100
    description: Duration of the align step before I/f.

  start-acceleration-rpm-per-s:
    type: int
    default: 3000
    description: I/f ramp of the forced speed.

  acceleration-rpm-per-s:
    type: int
    default: 5000
    description: Ramp of the speed reference in closed loop.

  current-bandwidth-hz:
    type: int
    default: 500
    description: Current-loop bandwidth (PI by pole cancellation).

  observer-bandwidth-hz:
    type: int
    default: 2000
    description: Observer bandwidth (double pole).

  pll-bandwidth-hz:
    type: int
    default: 150
    description: PLL natural frequency.

  speed-bandwidth-hz:
    type: int
    default: 50
    description: Speed-loop crossover.

  emf-min-millivolts:
    type: int
    default: 100
    description: The PLL gain falls off below this back-EMF estimate.
```

## dts/bindings/power-stage/pmsm,sim-power-stage.yaml
```yaml
# SPDX-License-Identifier: MIT

description: |
  Simulated three-phase power stage driving a PMSM plant model, for tests
  and samples on native_sim (see include/pmsm/power_stage_sim.h).

  The motor properties describe the simulated motor ("the truth"), not the
  controller's model of it, so a motor node can be given deliberately wrong
  parameters for robustness tests.

  Example (FIT1036 estimates, 24 V, 20 kHz):

    power_stage: power-stage {
      compatible = "pmsm,sim-power-stage";
      resistance-micro-ohms = <3600000>;
      inductance-nano-henries = <1500000>;
      flux-linkage-micro-webers = <11000>;
      pole-pairs = <11>;
      inertia-nano-kg-m2 = <6000>;
    };

compatible: "pmsm,sim-power-stage"

properties:
  pwm-frequency-hz:
    type: int
    default: 20000
    description: PWM frequency; one sample and callback per period.

  max-duty-permille:
    type: int
    default: 950
    description: |
      Highest duty applied, per mille; the lowest is 1000 minus this.
      Reported in power_stage_info.max_duty.

  duty-delay:
    type: int
    default: 1
    enum: [0, 1, 2]
    description: PWM periods from set_duty() to the applied duty (1 on hardware).

  dead-time-ns:
    type: int
    default: 0
    description: Reported in power_stage_info only; the simulated inverter is ideal.

  vbus-millivolts:
    type: int
    default: 24000
    description: Initial DC-bus voltage.

  resistance-micro-ohms:
    type: int
    required: true
    description: Phase resistance.

  inductance-nano-henries:
    type: int
    required: true
    description: Phase inductance (Ld = Lq).

  flux-linkage-micro-webers:
    type: int
    required: true
    description: Permanent-magnet flux linkage, peak per phase.

  pole-pairs:
    type: int
    required: true

  inertia-nano-kg-m2:
    type: int
    required: true
    description: Rotor plus load inertia.

  viscous-friction-nano-nm-s:
    type: int
    default: 0
    description: Viscous friction, nNm per rad/s.

  substeps:
    type: int
    default: 8
    description: RK4 integration steps per PWM period.

  tick-period-us:
    type: int
    default: 1000
    description: |
      Kernel timer period that drives the simulation; each expiry runs the
      PWM cycles due since the previous one, so simulated time follows the
      kernel clock (the period rounds up to whole kernel ticks). 0: no
      timer, the application steps the simulation with power_stage_sim_run().
```

## samples/motor_basic/sample.yaml
```yaml
sample:
  name: PMSM motor shell
  description: Sensorless FOC motor commanded from the shell
common:
  tags:
    - pmsm
    - motor
tests:
  pmsm.sample.motor_basic:
    platform_allow:
      - native_sim
    integration_platforms:
      - native_sim
    harness: console
    harness_config:
      type: one_line
      regex:
        - "motor ready: try 'motor start 500'"
```

## subsys/motor/Kconfig
```kconfig
# SPDX-License-Identifier: MIT

menuconfig PMSM_MOTOR
	bool "PMSM motor devices"
	default y
	depends on DT_HAS_PMSM_MOTOR_ENABLED
	select PMSM_FOC
	select PMSM_POWER_STAGE
	help
	  Motor devices (compatible "pmsm,motor"): sensorless FOC on a
	  power stage, with a motor thread for startup and speed control.
	  See include/pmsm/motor.h.

if PMSM_MOTOR

module = PMSM_MOTOR
module-str = pmsm_motor
source "subsys/logging/Kconfig.template.log_config"

config PMSM_MOTOR_INIT_PRIORITY
	int "Motor device init priority"
	default 60
	help
	  Must be above PMSM_POWER_STAGE_INIT_PRIORITY (checked at build
	  time).

config PMSM_MOTOR_PERIOD_US
	int "Motor thread period (us)"
	default 1000
	range 100 10000
	help
	  Period of the sequencer and speed loop. Must be a whole number of
	  kernel ticks (checked at build time); native_sim's default of
	  100 ticks/s needs CONFIG_SYS_CLOCK_TICKS_PER_SEC raised.

config PMSM_MOTOR_THREAD_PRIORITY
	int "Motor thread priority"
	default 2
	help
	  Preemptive priority; keep it above the shell and other application
	  threads so the speed loop keeps its period.

config PMSM_MOTOR_THREAD_STACK_SIZE
	int "Motor thread stack size"
	default 1024

endif # PMSM_MOTOR
```

## tests/motor/testcase.yaml
```yaml
common:
  tags:
    - pmsm
    - motor
tests:
  pmsm.motor:
    platform_allow:
      - native_sim
    integration_platforms:
      - native_sim
  pmsm.motor.sanitize:
    # ASan + UBSan, see tests/lib/foc/testcase.yaml.
    platform_allow:
      - native_sim/native/64
    integration_platforms:
      - native_sim/native/64
    extra_configs:
      - CONFIG_ASAN=y
      - CONFIG_ASAN_RECOVER=n
      - CONFIG_UBSAN=y
  pmsm.motor.build:
    # ARM warnings (float promotion, FPU thread options); the sim power stage stands in for
    # the STM32 driver (M5).
    build_only: true
    platform_allow:
      - nucleo_c542rc
    integration_platforms:
      - nucleo_c542rc
```

## tests/power_stage/testcase.yaml
```yaml
common:
  tags:
    - pmsm
    - power_stage
# Host only: the simulated power stage drives the double-precision plant.
tests:
  pmsm.power_stage.sim:
    platform_allow:
      - native_sim
    integration_platforms:
      - native_sim
  pmsm.power_stage.sim.sanitize:
    # ASan + UBSan, see tests/lib/foc/testcase.yaml.
    platform_allow:
      - native_sim/native/64
    integration_platforms:
      - native_sim/native/64
    extra_configs:
      - CONFIG_ASAN=y
      - CONFIG_ASAN_RECOVER=n
      - CONFIG_UBSAN=y
```

## tests/sim/testcase.yaml
```yaml
common:
  tags:
    - pmsm
    - sim
# Host only: the plant runs in double precision and has no target use.
tests:
  pmsm.sim:
    platform_allow:
      - native_sim
    integration_platforms:
      - native_sim
  pmsm.sim.sanitize:
    # ASan + UBSan, see tests/lib/foc/testcase.yaml.
    platform_allow:
      - native_sim/native/64
    integration_platforms:
      - native_sim/native/64
    extra_configs:
      - CONFIG_ASAN=y
      - CONFIG_ASAN_RECOVER=n
      - CONFIG_UBSAN=y
```
