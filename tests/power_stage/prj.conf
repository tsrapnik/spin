## CMakeLists.txt
```
# SPDX-License-Identifier: MIT

cmake_minimum_required(VERSION 3.20.0)
find_package(Zephyr REQUIRED HINTS $ENV{ZEPHYR_BASE})
project(pmsm_power_stage_test)

FILE(GLOB app_sources src/*.c)
target_sources(app PRIVATE ${app_sources})

# UBSan only reports and continues by default; make every finding abort the test.
if(CONFIG_UBSAN)
  zephyr_compile_options(-fno-sanitize-recover=all)
endif()
```

## prj.conf
```kconfig
CONFIG_ZTEST=y
CONFIG_PMSM_POWER_STAGE=y
```

## app.overlay
```dts
/* SPDX-License-Identifier: MIT */

/* FIT1036 estimates (docs/HARDWARE.md), 24 V, 20 kHz, as tests/sim. */
#define PS_FIT1036                                                                                 \
	compatible = "pmsm,sim-power-stage";                                                       \
	resistance-micro-ohms = <3600000>;                                                         \
	inductance-nano-henries = <1500000>;                                                       \
	flux-linkage-micro-webers = <11000>;                                                       \
	pole-pairs = <11>;                                                                         \
	inertia-nano-kg-m2 = <6000>

/ {
	/* Stepped by the tests with power_stage_sim_run(). */
	ps_manual: power-stage-manual {
		PS_FIT1036;
		tick-period-us = <0>;
	};

	/* Runs on its kernel timer. */
	ps_timer: power-stage-timer {
		PS_FIT1036;
	};
};
```

## src/ps_test.c
```c
/*
 * SPDX-License-Identifier: MIT
 */

#include <zephyr/ztest.h>
#include <pmsm/power_stage.h>
#include <pmsm/power_stage_sim.h>

#include "ps_test.h"

const struct device *const ps_manual = DEVICE_DT_GET(DT_NODELABEL(ps_manual));
const struct device *const ps_timer = DEVICE_DT_GET(DT_NODELABEL(ps_timer));

const struct plant_params ps_test_plant = {
	.rs = 3.6f,
	.ls = 1.5e-3f,
	.psi = 0.011f,
	.pole_pairs = 11U,
	.j = 6e-6f,
	.b = 0.0f,
	.vbus = 24.0f,
	.ts = 50e-6f,
	.duty_delay = 1U,
	.substeps = 8U,
};

void ps_test_reset(const struct device *dev)
{
	k_spinlock_key_t key;

	zassert_true(device_is_ready(dev));
	power_stage_disable(dev);
	power_stage_sim_brk(dev, false);
	zassert_ok(power_stage_register_cb(dev, NULL, NULL));
	power_stage_sim_set_offset(dev, 0.0f, 0.0f, 0.0f);

	struct plant *p = power_stage_sim_lock(dev, &key);
	int ret = plant_init(p, &ps_test_plant);

	power_stage_sim_unlock(dev, key);
	zassert_ok(ret);

	/* Zero current and no injected offset: calibrates the offsets to 0. */
	zassert_ok(power_stage_calibrate_offsets(dev));
	/* Drop a break flag still pending from a test. */
	if (dev == ps_manual) {
		zassert_ok(power_stage_sim_run(dev, 1U));
	}
}
```

## src/ps_test.h
```c
/*
 * SPDX-License-Identifier: MIT
 *
 * Shared fixture of the power-stage tests.
 */

#ifndef PMSM_TEST_PS_TEST_H_
#define PMSM_TEST_PS_TEST_H_

#include <zephyr/device.h>
#include <pmsm/plant.h>

/** \brief The manually stepped instance (tick-period-us = 0). */
extern const struct device *const ps_manual;
/** \brief The timer-driven instance. */
extern const struct device *const ps_timer;

/** \brief Plant parameters of both devicetree nodes (app.overlay). */
extern const struct plant_params ps_test_plant;

/**
 * \brief Outputs off, no callback, no offsets, plant back to its initial
 *        state.
 */
void ps_test_reset(const struct device *dev);

#endif /* PMSM_TEST_PS_TEST_H_ */
```

## src/test_closed_loop.c
```c
/*
 * SPDX-License-Identifier: MIT
 *
 * The whole drive through the power-stage API: foc_cycle in the per-cycle
 * callback, as the motor device will run it. The sequencer is stepped in
 * the callback too (every 1 ms), so the run stays deterministic. The motor
 * device runs it in its thread instead (tests/motor).
 */

#include <math.h>
#include <zephyr/ztest.h>
#include <pmsm/foc.h>
#include <pmsm/power_stage.h>
#include <pmsm/power_stage_sim.h>

#include "ps_test.h"

#define SEQ_TS 1e-3f

struct ctl {
	struct foc_cycle c;
	struct foc_seq s;
	struct foc_cmd cmd;
	struct foc_status st;
	unsigned int div, k;
	bool on;
};

static struct ctl ctl;

/* Per-cycle glue: break -> fault, controller step, outputs follow the state. */
static void on_sample(const struct device *dev, const struct power_stage_sample *smp, void *user)
{
	struct ctl *x = user;

	if (x->k++ % x->div == 0U) {
		x->cmd = *foc_seq_step(&x->s, &x->st);
	}
	if ((smp->flags & POWER_STAGE_FLAG_BREAK) != 0U) {
		foc_cycle_trip(&x->c, FOC_FAULT_EXT);
	}

	struct foc_abc i = {.a = smp->ia, .b = smp->ib, .c = smp->ic};
	struct foc_abc d = foc_cycle_step(&x->c, &x->cmd, i, smp->vbus, &x->st);
	bool on = x->st.state != FOC_STATE_STOP && x->st.state != FOC_STATE_FAULT;

	if (!on) {
		power_stage_disable(dev);
		x->on = false;
		return;
	}
	power_stage_set_duty(dev, d.a, d.b, d.c);
	if (!x->on) {
		x->on = power_stage_enable(dev) == 0;
	}
}

static void before(void *f)
{
	ARG_UNUSED(f);
	ps_test_reset(ps_manual);

	const struct power_stage_info *info = power_stage_get_info(ps_manual);
	/* As tests/sim/src/drive.c, with the timing from the power stage. */
	const struct foc_cycle_cfg cc = {
		.ts = info->ts,
		.rs = 3.6f,
		.ls = 1.5e-3f,
		.max_duty = info->max_duty,
		.t_adv = FOC_ADVANCE_PERIODS * info->ts,
		.delay = info->duty_delay,
		.bw_current_hz = 500.0f,
		.bw_obs_hz = 2000.0f,
		.bw_pll_hz = 150.0f,
		.w_max = 3000.0f,
		.e_min = 0.1f,
		.i_trip = 3.0f,
		.vbus_min = 10.0f,
		.vbus_max = 30.0f,
	};
	const struct foc_seq_cfg sc = {
		.ts = SEQ_TS,
		.pole_pairs = 11U,
		.j = 6e-6f,
		.psi = 0.011f,
		.bw_speed_hz = 50.0f,
		.i_max = 1.4f,
		.i_start = 1.0f,
		.t_align = 0.1f,
		.accel_start = 300.0f,
		.w_handover = 30.0f,
		.accel = 500.0f,
		.w_max = 100.0f,
	};

	ctl = (struct ctl){0};
	foc_cycle_init(&ctl.c, &cc);
	foc_seq_init(&ctl.s, &sc);
	ctl.cmd = ctl.s.cmd;
	ctl.st.state = FOC_STATE_STOP;
	ctl.div = (unsigned int)lroundf(SEQ_TS / info->ts);
	zassert_ok(power_stage_register_cb(ps_manual, on_sample, &ctl));
}

static void after(void *f)
{
	ARG_UNUSED(f);
	ps_test_reset(ps_manual);
}

static void run_s(float t)
{
	unsigned int n = (unsigned int)lroundf(t / power_stage_get_info(ps_manual)->ts);

	zassert_ok(power_stage_sim_run(ps_manual, n));
}

static double plant_wm(void)
{
	k_spinlock_key_t key;
	double w = power_stage_sim_lock(ps_manual, &key)->wm;

	power_stage_sim_unlock(ps_manual, key);
	return w;
}

/* Standstill -> RUN -> 50 rad/s, then the break trips it and stop clears it. */
ZTEST(power_stage_closed_loop, test_start_run_break_stop)
{
	foc_seq_start(&ctl.s, 50.0f);
	run_s(0.5f);
	zassert_equal(ctl.s.state, FOC_STATE_RUN, "state %d", ctl.s.state);
	run_s(0.3f);
	zassert_within(plant_wm(), 50.0, 2.5, "speed %f rad/s", plant_wm());
	zassert_true(ctl.on);

	power_stage_sim_brk(ps_manual, true);
	power_stage_sim_brk(ps_manual, false);
	run_s(0.005f);
	zassert_equal(ctl.st.state, FOC_STATE_FAULT);
	zassert_equal(ctl.st.faults, FOC_FAULT_EXT);
	zassert_false(ctl.on);

	foc_seq_stop(&ctl.s);
	run_s(0.005f);
	zassert_equal(ctl.st.state, FOC_STATE_STOP);
	zassert_equal(ctl.st.faults, 0U);
	zassert_false(ctl.on);
}

ZTEST_SUITE(power_stage_closed_loop, NULL, NULL, before, after, NULL);
```

## src/test_power_stage_sim.c
```c
/*
 * SPDX-License-Identifier: MIT
 *
 * Simulated power stage: API contract (timing, duty handling, offsets,
 * break) against the plant behind it.
 */

#include <float.h>
#include <math.h>
#include <zephyr/kernel.h>
#include <zephyr/ztest.h>
#include <pmsm/foc.h>
#include <pmsm/power_stage.h>
#include <pmsm/power_stage_sim.h>

#include "ps_test.h"

#define VBUS 24.0f

/* What the recording callback saw. */
struct rec {
	unsigned int n;
	struct power_stage_sample last;
	unsigned int brk; /* Samples with POWER_STAGE_FLAG_BREAK. */
	const struct device *dev;
	struct foc_abc duty; /* Set every cycle if set_duty is true. */
	bool set_duty;
};

static struct rec rec;

static void record(const struct device *dev, const struct power_stage_sample *s, void *user)
{
	struct rec *r = user;

	r->n++;
	r->last = *s;
	r->dev = dev;
	if ((s->flags & POWER_STAGE_FLAG_BREAK) != 0U) {
		r->brk++;
	}
	if (r->set_duty) {
		power_stage_set_duty(dev, r->duty.a, r->duty.b, r->duty.c);
	}
}

static struct plant plant_copy(const struct device *dev)
{
	k_spinlock_key_t key;
	struct plant p = *power_stage_sim_lock(dev, &key);

	power_stage_sim_unlock(dev, key);
	return p;
}

static void run(unsigned int n)
{
	zassert_ok(power_stage_sim_run(ps_manual, n));
}

static void before(void *f)
{
	ARG_UNUSED(f);
	ps_test_reset(ps_manual);
	rec = (struct rec){0};
	zassert_ok(power_stage_register_cb(ps_manual, record, &rec));
}

static void after(void *f)
{
	ARG_UNUSED(f);
	ps_test_reset(ps_manual);
}

ZTEST(power_stage_sim, test_info)
{
	const struct power_stage_info *info = power_stage_get_info(ps_manual);

	zassert_within(info->ts, 50e-6f, 1e-12f);
	zassert_within(info->max_duty, 0.95f, 1e-6f);
	zassert_equal(info->duty_delay, 1U);
	zassert_equal(info->dead_time, 0.0f);
}

/* One callback per cycle, with the plant's sample, whether the outputs are on or off. */
ZTEST(power_stage_sim, test_callback_every_cycle)
{
	uint64_t c0 = power_stage_sim_cycles(ps_manual);

	run(10U);
	zassert_equal(rec.n, 10U);
	zassert_equal(rec.dev, ps_manual);
	zassert_equal(power_stage_sim_cycles(ps_manual) - c0, 10U);
	zassert_within(rec.last.vbus, VBUS, 1e-6f);
	zassert_equal(rec.last.flags, 0U);

	zassert_ok(power_stage_enable(ps_manual));
	run(10U);
	zassert_equal(rec.n, 20U);
}

/* The sample is the plant state before the period, the currents are its phase currents. */
ZTEST(power_stage_sim, test_sample_matches_plant)
{
	rec.duty = (struct foc_abc){.a = 0.6f, .b = 0.45f, .c = 0.45f};
	rec.set_duty = true;
	zassert_ok(power_stage_enable(ps_manual));
	run(50U);

	struct plant p = plant_copy(ps_manual);
	struct plant_sample want = plant_sample(&p);

	run(1U);
	zassert_within(rec.last.ia, want.ia, 1e-6f);
	zassert_within(rec.last.ib, want.ib, 1e-6f);
	zassert_within(rec.last.ic, want.ic, 1e-6f);
	zassert_true(rec.last.ia > 0.1f, "no current with the outputs on: %f", (double)rec.last.ia);
}

/* A duty written in cycle k is applied in the period after cycle k + delay. */
ZTEST(power_stage_sim, test_duty_delay)
{
	const struct foc_abc d = {.a = 0.7f, .b = 0.4f, .c = 0.5f};

	zassert_ok(power_stage_enable(ps_manual));
	run(3U);

	/* Cycle k: the callback sets d. */
	rec.duty = d;
	rec.set_duty = true;
	run(1U);
	zassert_equal(plant_copy(ps_manual).applied.a, 0.5f, "applied without delay");

	run(1U);
	struct plant p = plant_copy(ps_manual);

	zassert_equal(p.applied.a, d.a);
	zassert_equal(p.applied.b, d.b);
	zassert_equal(p.applied.c, d.c);
}

/* The duty holds when not set again, as a compare register does. */
ZTEST(power_stage_sim, test_duty_holds)
{
	zassert_ok(power_stage_enable(ps_manual));
	power_stage_set_duty(ps_manual, 0.6f, 0.5f, 0.4f);
	run(5U);
	zassert_equal(plant_copy(ps_manual).applied.a, 0.6f);
	zassert_equal(plant_copy(ps_manual).applied.c, 0.4f);
}

/* Duties are clamped to [1 - max_duty, max_duty]; NaN counts as 0.5. */
ZTEST(power_stage_sim, test_duty_clamp)
{
	/* As the driver computes them (950 * 1e-3f, 1 - that), not the literals. */
	const float hi = power_stage_get_info(ps_manual)->max_duty;
	const float lo = 1.0f - hi;
	const struct {
		float in, out;
	} v[] = {
		{0.0f, lo},     {1.0f, hi},    {-INFINITY, lo}, {INFINITY, hi},
		{NAN, 0.5f},    {-NAN, 0.5f},  {lo, lo},        {hi, hi},
		{-FLT_MAX, lo}, {FLT_MAX, hi}, {FLT_MIN, lo},   {0.3f, 0.3f},
	};

	zassert_ok(power_stage_enable(ps_manual));
	for (size_t i = 0; i < ARRAY_SIZE(v); i++) {
		power_stage_set_duty(ps_manual, v[i].in, 0.5f, v[i].in);
		run(2U);

		struct plant p = plant_copy(ps_manual);

		zassert_equal(p.applied.a, v[i].out, "in %f: %f", (double)v[i].in,
			      (double)p.applied.a);
		zassert_equal(p.applied.c, v[i].out);
		zassert_equal(p.applied.b, 0.5f);
	}
}

/* Outputs off: the plant coasts and the duty is ignored. */
ZTEST(power_stage_sim, test_outputs_off)
{
	rec.duty = (struct foc_abc){.a = 0.9f, .b = 0.1f, .c = 0.5f};
	rec.set_duty = true;
	run(100U);

	struct plant p = plant_copy(ps_manual);

	zassert_equal(p.id, 0.0);
	zassert_equal(p.iq, 0.0);
	zassert_equal(p.applied.a, 0.5f);
	zassert_within(p.t, 101.0 * 50e-6, 1e-9, "time advances while off");
}

/* Disable switches off at once and resets the duty; enable resumes at 0.5. */
ZTEST(power_stage_sim, test_disable)
{
	zassert_ok(power_stage_enable(ps_manual));
	power_stage_set_duty(ps_manual, 0.7f, 0.4f, 0.4f);
	run(40U);
	zassert_true(fabs(plant_copy(ps_manual).id) + fabs(plant_copy(ps_manual).iq) > 0.1);

	power_stage_disable(ps_manual);
	run(1U);
	zassert_equal(plant_copy(ps_manual).id, 0.0);

	zassert_ok(power_stage_enable(ps_manual));
	run(3U);

	struct plant p = plant_copy(ps_manual);

	zassert_equal(p.applied.a, 0.5f);
	zassert_equal(p.applied.b, 0.5f);
}

/* Callback changes and calibration need the outputs off. */
ZTEST(power_stage_sim, test_busy_when_on)
{
	zassert_ok(power_stage_enable(ps_manual));
	zassert_equal(power_stage_register_cb(ps_manual, NULL, NULL), -EBUSY);
	zassert_equal(power_stage_calibrate_offsets(ps_manual), -EBUSY);
	run(1U);
	zassert_equal(rec.n, 1U, "callback was replaced");
}

/* Calibration removes an injected sense offset. */
ZTEST(power_stage_sim, test_offset_calibration)
{
	power_stage_sim_set_offset(ps_manual, 0.12f, -0.05f, 0.3f);
	run(1U);
	zassert_within(rec.last.ia, 0.12f, 1e-6f);
	zassert_within(rec.last.ic, 0.3f, 1e-6f);

	zassert_ok(power_stage_calibrate_offsets(ps_manual));
	run(1U);
	zassert_within(rec.last.ia, 0.0f, 1e-6f);
	zassert_within(rec.last.ib, 0.0f, 1e-6f);
	zassert_within(rec.last.ic, 0.0f, 1e-6f);

	/* Calibrated offsets stay removed with current flowing. */
	zassert_ok(power_stage_enable(ps_manual));
	power_stage_set_duty(ps_manual, 0.6f, 0.45f, 0.45f);
	run(50U);

	struct plant p = plant_copy(ps_manual);
	struct plant_sample want = plant_sample(&p);

	run(1U);
	zassert_within(rec.last.ia, want.ia, 1e-5f);
	zassert_within(rec.last.ib, want.ib, 1e-5f);
	zassert_within(rec.last.ic, want.ic, 1e-5f);
}

/* An offset beyond the sensing range is rejected; the old calibration stays. */
ZTEST(power_stage_sim, test_offset_out_of_range)
{
	power_stage_sim_set_offset(ps_manual, 2.0f, 0.0f, 0.0f);
	zassert_equal(power_stage_calibrate_offsets(ps_manual), -ERANGE);
	power_stage_sim_set_offset(ps_manual, NAN, 0.0f, 0.0f);
	zassert_equal(power_stage_calibrate_offsets(ps_manual), -ERANGE);

	power_stage_sim_set_offset(ps_manual, 0.0f, 0.0f, 0.0f);
	run(1U);
	zassert_within(rec.last.ia, 0.0f, 1e-6f);
}

/* The break switches off at once, is reported in one sample, and blocks enable while active. */
ZTEST(power_stage_sim, test_break)
{
	zassert_ok(power_stage_enable(ps_manual));
	power_stage_set_duty(ps_manual, 0.7f, 0.4f, 0.4f);
	run(20U);

	power_stage_sim_brk(ps_manual, true);
	run(1U);
	zassert_equal(rec.brk, 1U);
	zassert_equal(rec.last.flags, POWER_STAGE_FLAG_BREAK);
	zassert_equal(plant_copy(ps_manual).id, 0.0, "outputs still on");
	zassert_equal(power_stage_enable(ps_manual), -EIO);

	run(5U);
	zassert_equal(rec.brk, 1U, "break reported more than once");
	zassert_equal(plant_copy(ps_manual).id, 0.0);

	power_stage_sim_brk(ps_manual, false);
	zassert_ok(power_stage_enable(ps_manual));
	power_stage_set_duty(ps_manual, 0.7f, 0.4f, 0.4f);
	run(20U);
	zassert_true(plant_copy(ps_manual).id > 0.1);
	zassert_equal(rec.brk, 1U);
}

/* Disable from the callback (the controller's fault path) acts in the same cycle. */
static void disable_in_cb(const struct device *dev, const struct power_stage_sample *s, void *user)
{
	ARG_UNUSED(s);
	ARG_UNUSED(user);
	power_stage_set_duty(dev, 0.9f, 0.1f, 0.1f);
	power_stage_disable(dev);
}

ZTEST(power_stage_sim, test_disable_in_callback)
{
	zassert_ok(power_stage_register_cb(ps_manual, disable_in_cb, NULL));
	zassert_ok(power_stage_enable(ps_manual));
	run(1U);

	struct plant p = plant_copy(ps_manual);

	zassert_equal(p.id, 0.0);
	zassert_equal(p.applied.a, 0.5f);
}

/* The timer instance runs on its own, in batches; manual stepping is refused. */
ZTEST(power_stage_sim, test_timer_source)
{
	struct rec r = {0};

	ps_test_reset(ps_timer);
	zassert_equal(power_stage_sim_run(ps_timer, 1U), -EBUSY);
	zassert_ok(power_stage_register_cb(ps_timer, record, &r));

	uint64_t c0 = power_stage_sim_cycles(ps_timer);

	k_msleep(100);

	uint64_t n = power_stage_sim_cycles(ps_timer) - c0;

	zassert_ok(power_stage_register_cb(ps_timer, NULL, NULL));
	/* 20 cycles per ms, run in batches of up to one kernel tick. */
	unsigned int batch = 20000U / CONFIG_SYS_CLOCK_TICKS_PER_SEC + 1U;

	zassert_true(n + batch >= 2000U && n <= 2000U + batch, "%u cycles in 100 ms",
		     (unsigned int)n);
	zassert_true(r.n + batch >= 2000U && r.n <= n);
	zassert_equal(r.dev, ps_timer);
}

ZTEST_SUITE(power_stage_sim, NULL, NULL, before, after, NULL);
```
