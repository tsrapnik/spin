## CMakeLists.txt
```
# SPDX-License-Identifier: MIT

cmake_minimum_required(VERSION 3.20.0)
find_package(Zephyr REQUIRED HINTS $ENV{ZEPHYR_BASE})
project(pmsm_sim_test)

FILE(GLOB app_sources src/*.c)
target_sources(app PRIVATE ${app_sources})

# UBSan only reports and continues by default; make every finding abort the test.
if(CONFIG_UBSAN)
  zephyr_compile_options(-fno-sanitize-recover=all)
endif()
```

## prj.conf
```kconfig
CONFIG_ZTEST=y
CONFIG_PMSM_PLANT=y
```

## src/drive.c
```c
/*
 * SPDX-License-Identifier: MIT
 */

#include <math.h>
#include <zephyr/ztest.h>

#include "drive.h"

const struct foc_cycle_cfg drive_cycle_cfg = {
	.ts = 50e-6f,
	.rs = 3.6f,
	.ls = 1.5e-3f,
	.max_duty = 0.95f,
	.t_adv = FOC_ADVANCE_PERIODS * 50e-6f,
	.delay = 1U,
	.bw_current_hz = 500.0f,
	.bw_obs_hz = 2000.0f,
	.bw_pll_hz = 150.0f,
	.w_max = 3000.0f,
	.e_min = 0.1f,
	.i_trip = 3.0f,
	.vbus_min = 10.0f,
	.vbus_max = 30.0f,
};

const struct foc_seq_cfg drive_seq_cfg = {
	.ts = 1e-3f,
	.pole_pairs = 11U,
	.j = 6e-6f,
	.psi = 0.011f,
	.bw_speed_hz = 50.0f,
	.i_max = 1.4f,
	.i_start = 1.0f,
	.t_align = 0.1f,
	.accel_start = 300.0f,
	.w_handover = 30.0f,
	.accel = 500.0f,
	.w_max = 100.0f,
};

void drive_init(struct drive *d, const struct plant_params *prm, const struct foc_cycle_cfg *cc,
		const struct foc_seq_cfg *sc)
{
	*d = (struct drive){0};
	zassert_equal(plant_init(&d->p, prm), 0);
	foc_cycle_init(&d->c, cc);
	foc_seq_init(&d->s, sc);
	d->div = (unsigned int)(sc->ts / cc->ts + 0.5f);
	d->cmd = d->s.cmd;
	d->st.state = FOC_STATE_STOP;
}

void drive_cycle(struct drive *d)
{
	if (d->k % d->div == 0U) {
		d->cmd = *foc_seq_step(&d->s, &d->st);
	}

	struct plant_sample smp = plant_sample(&d->p);
	struct foc_abc i = {
		.a = smp.ia + d->i_add.a, .b = smp.ib + d->i_add.b, .c = smp.ic + d->i_add.c};

	d->theta_smp = d->p.theta_e;

	struct foc_abc duty = foc_cycle_step(&d->c, &d->cmd, i, smp.vbus, &d->st);

	d->pwm = d->st.state != FOC_STATE_STOP && d->st.state != FOC_STATE_FAULT;
	if (d->pwm) {
		plant_step(&d->p, duty);
	} else {
		plant_coast(&d->p);
	}
	d->k++;
}

void drive_run(struct drive *d, float t)
{
	unsigned int n = (unsigned int)(t / (float)d->p.ts + 0.5f);

	for (unsigned int i = 0; i < n; i++) {
		drive_cycle(d);
	}
}

double drive_until(struct drive *d, enum foc_state st, float t_max)
{
	double t0 = d->p.t;

	while (d->p.t - t0 < (double)t_max) {
		drive_cycle(d);
		if (d->s.state == st) {
			return d->p.t - t0;
		}
	}
	return -1.0;
}

double drive_angle_err(const struct drive *d)
{
	double e = (double)d->st.theta - d->theta_smp;

	return e - 2.0 * PLANT_PI * round(e / (2.0 * PLANT_PI));
}
```

## src/drive.h
```c
/*
 * SPDX-License-Identifier: MIT
 *
 * Full drive on the plant: foc_cycle every PWM cycle (the ISR), foc_seq every
 * div cycles (the 1 kHz motor thread), exchanging foc_cmd and foc_status as
 * in the motor device. Deterministic: no threads or timers.
 */

#ifndef PMSM_SIM_DRIVE_H_
#define PMSM_SIM_DRIVE_H_

#include <stdbool.h>
#include <pmsm/foc.h>
#include <pmsm/plant.h>

struct drive {
	struct plant p;
	struct foc_cycle c;
	struct foc_seq s;
	struct foc_status st;
	struct foc_cmd cmd;   /**< Latest command, as the ISR sees it. */
	unsigned int div;     /**< PWM cycles per sequencer step. */
	unsigned int k;       /**< PWM cycle count. */
	double theta_smp;     /**< True angle at the latest sample. */
	bool pwm;             /**< Power stage on (state ALIGN, IF or RUN). */
	struct foc_abc i_add; /**< Added to the sampled currents (fault injection). */
};

/** \brief Controller settings for the FIT1036 estimates (see sim_motor). */
extern const struct foc_cycle_cfg drive_cycle_cfg;
extern const struct foc_seq_cfg drive_seq_cfg;

void drive_init(struct drive *d, const struct plant_params *prm, const struct foc_cycle_cfg *cc,
		const struct foc_seq_cfg *sc);
/** \brief One PWM cycle; with the PWM off the plant sees open phases (no current). */
void drive_cycle(struct drive *d);
void drive_run(struct drive *d, float t);
/** \brief Run until the sequencer is in \p st, at most \p t_max; returns the time taken or -1. */
double drive_until(struct drive *d, enum foc_state st, float t_max);
/** \brief PLL angle minus true angle at the latest sample, wrapped. */
double drive_angle_err(const struct drive *d);

#endif /* PMSM_SIM_DRIVE_H_ */
```

## src/sim.c
```c
/*
 * SPDX-License-Identifier: MIT
 */

#include <math.h>
#include <zephyr/ztest.h>

#include "sim.h"

const struct plant_params sim_motor = {
	.rs = 3.6f,
	.ls = 1.5e-3f,
	.psi = 0.011f,
	.pole_pairs = 11U,
	.j = 6e-6f,
	.b = 1e-6f,
	.vbus = 24.0f,
	.ts = 50e-6f,
	.duty_delay = 1U,
	.substeps = 8U,
};

const struct sim_cfg sim_default_cfg = {
	.bw_current_hz = 500.0f,
	.bw_speed_hz = 50.0f,
	.i_max = 1.4f,
	.max_duty = 0.95f,
	.speed_div = 20U,
	.adv_periods = FOC_ADVANCE_PERIODS,
	.bw_obs_hz = 2000.0f,
	.bw_pll_hz = 150.0f,
	.w_max_e = 3000.0f,
	.e_min = 0.1f,
	.obs_delay = 1U,
};

static float scale(float x)
{
	return x > 0.0f ? x : 1.0f;
}

void sim_init(struct sim *s, const struct plant_params *prm, const struct sim_cfg *cfg)
{
	float kt = foc_torque_constant(prm->psi, prm->pole_pairs);

	*s = (struct sim){.cfg = *cfg};
	zassert_equal(plant_init(&s->p, prm), 0);
	foc_current_init(&s->cur, foc_gains_current(prm->rs, prm->ls, cfg->bw_current_hz), prm->ts,
			 cfg->max_duty, cfg->adv_periods * prm->ts);
	foc_pi_init(&s->speed, foc_gains_speed(prm->j, kt, cfg->bw_speed_hz),
		    prm->ts * (float)cfg->speed_div);
	foc_obs_init(&s->obs, prm->rs * scale(cfg->obs_rs_scale),
		     prm->ls * scale(cfg->obs_ls_scale), prm->ts, cfg->bw_obs_hz, 4.0f * cfg->i_max,
		     2.0f * prm->vbus);
	foc_pll_init(&s->pll, foc_gains_pll(cfg->bw_pll_hz), prm->ts, cfg->w_max_e, cfg->e_min);
	foc_duty_hist_init(&s->hist, cfg->obs_delay);
}

void sim_cycle(struct sim *s)
{
	struct plant_sample smp = plant_sample(&s->p);
	struct foc_abc i_abc = {.a = smp.ia, .b = smp.ib, .c = smp.ic};
	struct foc_ab v = foc_duty_to_ab(foc_duty_hist_applied(&s->hist), smp.vbus);

	s->theta_smp = s->p.theta_e;
	foc_pll_step(&s->pll, foc_obs_step(&s->obs, foc_clarke(i_abc), v, s->pll.omega));

	float theta = s->sensorless ? s->pll.theta : (float)s->p.theta_e;
	float wm = s->sensorless ? s->pll.omega / (float)s->p.pp : (float)s->p.wm;

	if (s->speed_loop && (s->k % s->cfg.speed_div) == 0U) {
		s->i_ref.q = foc_pi_step(&s->speed, s->w_ref - wm, -s->cfg.i_max, s->cfg.i_max);
	}

	struct foc_abc duty =
		foc_current_step(&s->cur, i_abc, smp.vbus, theta, (float)s->p.pp * wm, s->i_ref);

	plant_step(&s->p, duty);
	foc_duty_hist_push(&s->hist, duty);
	s->k++;
}

void sim_run(struct sim *s, unsigned int n)
{
	for (unsigned int i = 0; i < n; i++) {
		sim_cycle(s);
	}
}

unsigned int sim_cycles(const struct sim *s, float t)
{
	return (unsigned int)(t / (float)s->p.ts + 0.5f);
}

double sim_angle_err(const struct sim *s)
{
	double d = (double)s->pll.theta - s->theta_smp;

	return d - 2.0 * PLANT_PI * round(d / (2.0 * PLANT_PI));
}

double sim_w_est(const struct sim *s)
{
	return (double)s->pll.omega / s->p.pp;
}
```

## src/sim.h
```c
/*
 * SPDX-License-Identifier: MIT
 *
 * Closed-loop harness: plant + FOC core. The current loop runs every PWM
 * cycle, the speed PI every speed_div cycles (the 1 kHz motor thread), as
 * decided in docs/PLAN.md. The observer and PLL run every cycle on the
 * sampled current and the applied duty; with sensorless = false the loops
 * use the true angle and speed, otherwise the estimates.
 */

#ifndef PMSM_SIM_SIM_H_
#define PMSM_SIM_SIM_H_

#include <stdbool.h>
#include <pmsm/foc.h>
#include <pmsm/plant.h>

/** \brief Controller settings. */
struct sim_cfg {
	float bw_current_hz;    /**< Current-loop bandwidth. */
	float bw_speed_hz;      /**< Speed-loop crossover. */
	float i_max;            /**< q-current limit of the speed PI, A. */
	float max_duty;         /**< SVPWM duty limit. */
	unsigned int speed_div; /**< PWM cycles per speed-PI step. */
	float adv_periods;      /**< Angle advance, PWM periods. */
	float bw_obs_hz;        /**< Observer bandwidth. */
	float bw_pll_hz;        /**< PLL natural frequency. */
	float w_max_e;          /**< PLL speed limit, rad/s electrical. */
	float e_min;            /**< PLL gain fall-off below this EMF, V. */
	unsigned int obs_delay; /**< Duty delay the observer assumes. */
	float obs_rs_scale;     /**< Observer Rs / plant Rs (0 counts as 1). */
	float obs_ls_scale;     /**< Observer Ls / plant Ls (0 counts as 1). */
};

struct sim {
	struct plant p;
	struct sim_cfg cfg;
	struct foc_current cur;
	struct foc_pi speed;
	struct foc_obs obs;
	struct foc_pll pll;
	struct foc_duty_hist hist;
	bool sensorless;     /**< Control with the estimated angle and speed. */
	bool speed_loop;     /**< false: i_ref is set directly. */
	float w_ref;         /**< Mechanical speed reference, rad/s. */
	struct foc_dq i_ref; /**< Current reference, A (speed PI writes q). */
	unsigned int k;      /**< PWM cycle count. */
	double theta_smp;    /**< True angle at the latest sample. */
};

/** \brief FIT1036 estimates from docs/HARDWARE.md, 24 V, 20 kHz, delay 1. */
extern const struct plant_params sim_motor;
/**
 * \brief Default controller: 500 Hz current, 50 Hz speed, 1.4 A, 0.95, 1 kHz;
 *        observer 2 kHz, PLL 150 Hz.
 */
extern const struct sim_cfg sim_default_cfg;

void sim_init(struct sim *s, const struct plant_params *prm, const struct sim_cfg *cfg);
/** \brief One PWM cycle: sample, (speed PI), current loop, plant step. */
void sim_cycle(struct sim *s);
/** \brief Run \p n PWM cycles. */
void sim_run(struct sim *s, unsigned int n);
/** \brief PWM cycles in \p t seconds. */
unsigned int sim_cycles(const struct sim *s, float t);
/** \brief PLL angle minus true angle at the latest sample, wrapped to [-pi, pi]. */
double sim_angle_err(const struct sim *s);
/** \brief PLL speed estimate, rad/s mechanical. */
double sim_w_est(const struct sim *s);

#endif /* PMSM_SIM_SIM_H_ */
```

## src/test_current_loop.c
```c
/*
 * SPDX-License-Identifier: MIT
 *
 * Current loop on the plant with the true angle: step responses at
 * standstill and at speed, angle advance, voltage limit.
 */

#include <math.h>
#include <zephyr/ztest.h>

#include "sim.h"

/* Inertia so large that the speed stays where it is set. */
#define J_STIFF 1e6f

struct step_result {
	double t63;  /**< Time to 63.2 % of the step, s. */
	double peak; /**< Highest iq. */
	double id_max;
	double iq_end, id_end;
};

/* Step iq_ref 0 -> i_step after 20 ms at constant speed wm, run for t_run. */
static struct step_result current_step(float bw, float wm, float adv, float i_step, float t_run)
{
	struct plant_params m = sim_motor;
	struct sim_cfg c = sim_default_cfg;
	struct step_result r = {.t63 = -1.0};
	struct sim s;

	m.j = J_STIFF;
	c.bw_current_hz = bw;
	c.adv_periods = adv;
	sim_init(&s, &m, &c);
	s.p.wm = (double)wm;
	/* Let the short-circuit transient from the back-EMF die out first. */
	sim_run(&s, sim_cycles(&s, 0.02f));

	double t0 = s.p.t;

	s.i_ref.q = i_step;
	for (unsigned int k = 0; k < sim_cycles(&s, t_run); k++) {
		sim_cycle(&s);
		r.peak = fmax(r.peak, s.p.iq);
		r.id_max = fmax(r.id_max, fabs(s.p.id));
		if (r.t63 < 0.0 && s.p.iq >= 0.632 * (double)i_step) {
			r.t63 = s.p.t - t0;
		}
	}
	r.iq_end = s.p.iq;
	r.id_end = s.p.id;
	return r;
}

static double tau_of(float bw)
{
	return 1.0 / (2.0 * (double)FOC_PI_F * (double)bw);
}

/*
 * Standstill: pole cancellation gives a first-order response with time
 * constant 1/wc. The one-period duty delay adds no overshoot at fs/40.
 */
ZTEST(sim_current, test_step_standstill)
{
	const float bw = 500.0f;
	struct step_result r = current_step(bw, 0.0f, FOC_ADVANCE_PERIODS, 1.0f, 0.01f);
	double tau = tau_of(bw);

	zassert_true(r.t63 > 0.8 * tau && r.t63 < 1.2 * tau, "t63 %g tau %g", r.t63, tau);
	zassert_true(r.peak < 1.005, "peak %f", r.peak);
	zassert_within(r.iq_end, 1.0, 1e-4);
	zassert_within(r.id_max, 0.0, 1e-6);
}

/*
 * At speed (about 380 rpm, back-EMF 4.8 V) in both directions: the
 * integrators remove the back-EMF and cross-coupling, d sees only a small
 * transient.
 */
ZTEST(sim_current, test_step_at_speed)
{
	const float bw = 500.0f;
	const float speeds[] = {40.0f, -40.0f};

	for (size_t i = 0; i < ARRAY_SIZE(speeds); i++) {
		struct step_result r =
			current_step(bw, speeds[i], FOC_ADVANCE_PERIODS, 1.0f, 0.01f);
		double tau = tau_of(bw);

		zassert_true(r.t63 > 0.8 * tau && r.t63 < 1.2 * tau, "wm %f t63 %g",
			     (double)speeds[i], r.t63);
		zassert_true(r.peak < 1.01, "peak %f", r.peak);
		zassert_within(r.iq_end, 1.0, 1e-4);
		zassert_true(r.id_max < 0.08, "id_max %f", r.id_max);
		zassert_within(r.id_end, 0.0, 1e-4);
	}
}

/* Advancing the inverse-Park angle by 1.5 periods reduces the d excursion. */
ZTEST(sim_current, test_angle_advance_helps)
{
	struct step_result with = current_step(500.0f, 40.0f, FOC_ADVANCE_PERIODS, 1.0f, 0.01f);
	struct step_result without = current_step(500.0f, 40.0f, 0.0f, 1.0f, 0.01f);

	zassert_true(with.id_max < 0.9 * without.id_max, "with %f without %f", with.id_max,
		     without.id_max);
}

/* Rule of thumb in foc_gains_current(): bandwidth <= fs/20 keeps overshoot small. */
ZTEST(sim_current, test_bandwidth_rule)
{
	const float fs = 1.0f / sim_motor.ts;
	struct step_result r = current_step(fs / 20.0f, 0.0f, FOC_ADVANCE_PERIODS, 1.0f, 0.01f);

	zassert_true(r.peak < 1.05, "fs/20: peak %f", r.peak);
	zassert_within(r.iq_end, 1.0, 1e-4);
}

/*
 * Voltage limit at about 760 rpm (back-EMF 9.7 V of 12.5 V available): 1 A
 * is out of reach. The voltage sits on the circle, the integrators do not
 * wind up, and a reachable reference is tracked again within a few tau.
 */
ZTEST(sim_current, test_voltage_limit_recovery)
{
	struct plant_params m = sim_motor;
	const float vmax = foc_svpwm_vmax(sim_motor.vbus, sim_default_cfg.max_duty);
	struct sim s;

	m.j = J_STIFF;
	sim_init(&s, &m, &sim_default_cfg);
	s.p.wm = 80.0;
	s.i_ref.q = 1.0f;
	sim_run(&s, sim_cycles(&s, 0.05f));

	zassert_true(s.p.iq < 0.9, "iq %f must be voltage-limited", s.p.iq);
	zassert_within(hypotf(s.cur.v.d, s.cur.v.q), vmax, 1e-3f);
	zassert_true(fabsf(s.cur.q.integ) <= vmax);

	s.i_ref.q = 0.3f;
	sim_run(&s, sim_cycles(&s, 6.0f * (float)tau_of(sim_default_cfg.bw_current_hz)));
	zassert_within(s.p.iq, 0.3, 0.02, "iq %f", s.p.iq);
	sim_run(&s, sim_cycles(&s, 0.01f));
	zassert_within(s.p.iq, 0.3, 1e-4, "iq %f", s.p.iq);
}

ZTEST_SUITE(sim_current, NULL, NULL, NULL, NULL, NULL);
```

## src/test_faults.c
```c
/*
 * SPDX-License-Identifier: MIT
 *
 * Per-cycle faults on the full drive: over-current, over- and under-voltage,
 * a broken current reading and an external trip. Each switches the PWM off
 * in the cycle it is seen, latches until stop, and a restart then works.
 */

#include <math.h>
#include <zephyr/ztest.h>

#include "drive.h"
#include "sim.h"

static void running(struct drive *d)
{
	drive_init(d, &sim_motor, &drive_cycle_cfg, &drive_seq_cfg);
	foc_seq_start(&d->s, 50.0f);
	drive_run(d, 0.4f);
	zassert_equal(d->s.state, FOC_STATE_RUN);
	zassert_within(d->p.wm, 50.0, 1e-3);
}

/* The fault takes the PWM off in this very cycle and latches. */
static void expect_trip(struct drive *d, unsigned int bit)
{
	drive_cycle(d);
	zassert_equal(d->st.state, FOC_STATE_FAULT);
	zassert_true((d->st.faults & bit) != 0U, "faults %x", d->st.faults);
	zassert_false(d->pwm);
	zassert_equal(d->p.id, 0.0);
	/* The sequencer sees it at its next step and stays in FAULT. */
	drive_run(d, 0.05f);
	zassert_equal(d->s.state, FOC_STATE_FAULT);
	zassert_true((d->s.faults & bit) != 0U);
	zassert_equal(d->cmd.state, FOC_STATE_FAULT);
	zassert_false(d->pwm);
}

/* Fault condition gone: stop clears it, a start from rest works again. */
static void clear_and_restart(struct drive *d)
{
	foc_seq_start(&d->s, 50.0f); /* ignored: not stopped */
	drive_run(d, 0.01f);
	zassert_equal(d->s.state, FOC_STATE_FAULT);

	foc_seq_stop(&d->s);
	drive_run(d, 0.01f);
	zassert_equal(d->s.state, FOC_STATE_STOP);
	zassert_equal(d->st.state, FOC_STATE_STOP);
	zassert_equal(d->st.faults, 0U);

	d->p.wm = 0.0;
	foc_seq_start(&d->s, 50.0f);
	zassert_true(drive_until(d, FOC_STATE_RUN, 0.3f) > 0.0);
	drive_run(d, 0.3f);
	zassert_true(d->pwm);
	zassert_within(d->p.wm, 50.0, 1e-3);
}

/* A current-sense offset pushes one phase past the trip level. */
ZTEST(sim_faults, test_over_current)
{
	struct drive d;

	running(&d);
	d.i_add.a = drive_cycle_cfg.i_trip;
	expect_trip(&d, FOC_FAULT_OC);
	d.i_add.a = 0.0f;
	clear_and_restart(&d);
}

ZTEST(sim_faults, test_over_voltage)
{
	struct drive d;

	running(&d);
	d.p.vbus = 31.0;
	expect_trip(&d, FOC_FAULT_OV);
	d.p.vbus = 24.0;
	clear_and_restart(&d);
}

ZTEST(sim_faults, test_under_voltage)
{
	struct drive d;

	running(&d);
	d.p.vbus = 9.0;
	expect_trip(&d, FOC_FAULT_UV);
	d.p.vbus = 24.0;
	clear_and_restart(&d);
}

/* A NaN reading is a fault, not a zero. */
ZTEST(sim_faults, test_nan_reading)
{
	struct drive d;

	running(&d);
	d.i_add.b = NAN;
	expect_trip(&d, FOC_FAULT_OC);
	d.i_add.b = 0.0f;
	clear_and_restart(&d);
}

/* External trip (hardware break input). */
ZTEST(sim_faults, test_external_trip)
{
	struct drive d;

	running(&d);
	foc_cycle_trip(&d.c, FOC_FAULT_EXT);
	expect_trip(&d, FOC_FAULT_EXT);
	clear_and_restart(&d);
}

/* Faults with the PWM off are ignored: an under-voltage at rest does not latch. */
ZTEST(sim_faults, test_ignored_while_stopped)
{
	struct drive d;

	drive_init(&d, &sim_motor, &drive_cycle_cfg, &drive_seq_cfg);
	d.p.vbus = 5.0;
	drive_run(&d, 0.01f);
	zassert_equal(d.st.state, FOC_STATE_STOP);
	zassert_equal(d.st.faults, 0U);
	/* Starting at that voltage trips at the first active cycle. */
	foc_seq_start(&d.s, 50.0f);
	zassert_true(drive_until(&d, FOC_STATE_FAULT, 0.01f) > 0.0);
	zassert_equal(d.s.faults, FOC_FAULT_UV);
}

ZTEST_SUITE(sim_faults, NULL, NULL, NULL, NULL, NULL);
```

## src/test_observer.c
```c
/*
 * SPDX-License-Identifier: MIT
 *
 * Observer + PLL against the plant angle. The loops run on the true angle
 * (sensorless = false) unless a test switches over; the observer and PLL
 * always run on the sampled current and the applied duty, from zero state.
 */

#include <math.h>
#include <zephyr/ztest.h>

#include "sim.h"

struct track {
	double ang;   /**< Largest |angle error|, rad electrical. */
	double w;     /**< Largest |speed error|, rad/s mechanical. */
	double e_rel; /**< Largest relative error of |e_hat| against p psi |wm|. */
	double r;     /**< Largest |prediction error|, A. */
};

static struct track measure(struct sim *s, float t)
{
	struct track r = {0};

	for (unsigned int k = 0; k < sim_cycles(s, t); k++) {
		/* EMF at this sample, before the plant moves on. */
		double e_true = s->p.pp * (double)sim_motor.psi * fabs(s->p.wm);

		sim_cycle(s);
		r.ang = fmax(r.ang, fabs(sim_angle_err(s)));
		r.w = fmax(r.w, fabs(sim_w_est(s) - s->p.wm));
		r.e_rel = fmax(r.e_rel,
			       fabs(hypot((double)s->obs.e.alpha, (double)s->obs.e.beta) - e_true) /
				       e_true);
		r.r = fmax(r.r, hypot((double)s->obs.err.alpha, (double)s->obs.err.beta));
	}
	return r;
}

/* Speed loop on the true angle to w (with load), then measure for 0.1 s. */
static struct track run_at(const struct plant_params *prm, const struct sim_cfg *cfg, float w,
			   double load)
{
	struct sim s;

	sim_init(&s, prm, cfg);
	s.speed_loop = true;
	s.w_ref = w;
	s.p.t_load = load;
	sim_run(&s, sim_cycles(&s, 0.3f));
	return measure(&s, 0.1f);
}

/* Each sample is paired with the duty the plant applied before it. */
ZTEST(sim_observer, test_duty_pairing)
{
	for (unsigned int d = 0; d <= PLANT_DUTY_DELAY_MAX; d++) {
		struct plant_params prm = sim_motor;
		struct sim_cfg cfg = sim_default_cfg;
		struct sim s;

		prm.duty_delay = d;
		cfg.obs_delay = d;
		sim_init(&s, &prm, &cfg);
		s.speed_loop = true;
		s.w_ref = 50.0f;
		for (unsigned int k = 0; k < sim_cycles(&s, 0.05f); k++) {
			sim_cycle(&s);
			struct foc_abc a = foc_duty_hist_applied(&s.hist);

			zassert_true(a.a == s.p.applied.a && a.b == s.p.applied.b &&
					     a.c == s.p.applied.c,
				     "delay %u cycle %u", d, k);
		}
	}
}

/*
 * Constant speed, both directions, with and without load: angle, speed and
 * EMF magnitude match the plant. The observer starts from zero at
 * standstill and acquires during the speed-up.
 */
ZTEST(sim_observer, test_constant_speed)
{
	const float ws[] = {5.0f, 20.0f, 50.0f, 90.0f, -50.0f};
	const double loads[] = {0.0, 0.05};

	for (size_t i = 0; i < ARRAY_SIZE(ws); i++) {
		for (size_t l = 0; l < ARRAY_SIZE(loads); l++) {
			double load = copysign(loads[l], (double)ws[i]);
			struct track r = run_at(&sim_motor, &sim_default_cfg, ws[i], load);

			zassert_true(r.ang < 1e-3, "w %f load %f: angle %e", (double)ws[i], load,
				     r.ang);
			zassert_true(r.w < 1e-3, "w %f load %f: speed %e", (double)ws[i], load,
				     r.w);
			zassert_true(r.e_rel < 1e-3, "w %f load %f: |e| %e", (double)ws[i], load,
				     r.e_rel);
		}
	}
}

/*
 * The observer must use the duty that was actually applied. Assuming one
 * period too few or too many costs 100 times the angle error, under load
 * at 50 rad/s. The prediction error does not show it: at constant speed
 * the EMF estimate absorbs the voltage error.
 */
ZTEST(sim_observer, test_delay_mismatch)
{
	struct sim_cfg cfg = sim_default_cfg;
	struct track ok = run_at(&sim_motor, &cfg, 50.0f, 0.05);

	zassert_true(ok.r < 1e-5, "r %e", ok.r);
	for (unsigned int d = 0; d <= 2U; d += 2U) {
		cfg.obs_delay = d;
		struct track bad = run_at(&sim_motor, &cfg, 50.0f, 0.05);

		zassert_true(bad.ang > 0.02 && bad.ang > 50.0 * ok.ang, "delay %u angle %e", d,
			     bad.ang);
	}
}

/*
 * Parameter errors of +-30 %, under load. With id = 0 an Rs error acts along
 * the EMF (q), so it only scales |e|; an Ls error acts across it (w L iq on
 * d) and shows as an angle error.
 */
ZTEST(sim_observer, test_parameter_error)
{
	const float sc[] = {0.7f, 1.3f};

	for (size_t i = 0; i < ARRAY_SIZE(sc); i++) {
		struct sim_cfg cfg = sim_default_cfg;
		struct track r;

		cfg.obs_rs_scale = sc[i];
		r = run_at(&sim_motor, &cfg, 50.0f, 0.05);
		zassert_true(r.ang < 2e-3, "rs x%f: angle %e", (double)sc[i], r.ang);
		zassert_true(r.e_rel < 0.1, "rs x%f: |e| %e", (double)sc[i], r.e_rel);

		cfg = sim_default_cfg;
		cfg.obs_ls_scale = sc[i];
		r = run_at(&sim_motor, &cfg, 50.0f, 0.05);
		zassert_true(r.ang < 0.02, "ls x%f: angle %e", (double)sc[i], r.ang);
	}
}

/* PLL preloaded with the wrong direction at 50 rad/s: relocks within 30 ms. */
ZTEST(sim_observer, test_wrong_direction_preload)
{
	struct sim s;
	struct track r;

	sim_init(&s, &sim_motor, &sim_default_cfg);
	s.speed_loop = true;
	s.w_ref = 50.0f;
	sim_run(&s, sim_cycles(&s, 0.3f));
	foc_pll_reset(&s.pll, s.pll.theta, -s.pll.omega);
	foc_obs_reset(&s.obs);
	sim_run(&s, sim_cycles(&s, 0.03f));
	r = measure(&s, 0.05f);
	zassert_true(r.ang < 1e-3 && r.w < 1e-3, "angle %e speed %e", r.ang, r.w);
}

/*
 * Sensorless closed loop: switch from the true to the estimated angle at
 * 50 rad/s, then a load step and a speed step. Start-up from standstill
 * follows in M3.2.
 */
ZTEST(sim_observer, test_sensorless_closed_loop)
{
	struct sim s;
	struct track r;

	sim_init(&s, &sim_motor, &sim_default_cfg);
	s.speed_loop = true;
	s.w_ref = 50.0f;
	sim_run(&s, sim_cycles(&s, 0.3f));
	s.sensorless = true;
	r = measure(&s, 0.1f);
	zassert_true(r.ang < 1e-3, "switch: angle %e", r.ang);

	s.p.t_load = 0.05;
	r = measure(&s, 0.2f);
	zassert_true(r.ang < 0.05, "load step: angle %e", r.ang);
	zassert_within(s.p.wm, 50.0, 1e-3);

	s.w_ref = 80.0f;
	r = measure(&s, 0.2f);
	zassert_true(r.ang < 0.1, "speed step: angle %e", r.ang);
	zassert_within(s.p.wm, 80.0, 1e-3);
	zassert_true(fabs(sim_angle_err(&s)) < 1e-3);
}

ZTEST_SUITE(sim_observer, NULL, NULL, NULL, NULL, NULL);
```

## src/test_plant.c
```c
/*
 * SPDX-License-Identifier: MIT
 */

#include <math.h>
#include <zephyr/ztest.h>
#include <pmsm/foc.h>
#include <pmsm/plant.h>

#define RS      3.6f
#define LS      1.5e-3f
#define PSI     0.011f
#define PP      11U
#define VBUS    24.0f
#define TS      50e-6f
/* Large enough that the speed stays constant: a "locked" or "driven" rotor. */
#define J_STIFF 1e6f

static const struct plant_params base = {
	.rs = RS,
	.ls = LS,
	.psi = PSI,
	.pole_pairs = PP,
	.j = 6e-6f,
	.b = 0.0f,
	.vbus = VBUS,
	.ts = TS,
	.duty_delay = 1U,
	.substeps = 8U,
};

/* Duties that apply the stationary-frame voltage v (max duty 1: no clamping). */
static struct foc_abc duty_for(float valpha, float vbeta)
{
	return foc_svpwm((struct foc_ab){.alpha = valpha, .beta = vbeta}, VBUS, 1.0f);
}

static void init(struct plant *p, struct plant_params prm)
{
	zassert_equal(plant_init(p, &prm), 0);
}

ZTEST(plant, test_init_rejects_bad_params)
{
	struct plant p;
	struct plant_params prm = base;

	prm.ls = 0.0f;
	zassert_equal(plant_init(&p, &prm), -1);
	prm = base;
	prm.rs = NAN;
	zassert_equal(plant_init(&p, &prm), -1);
	prm = base;
	prm.pole_pairs = 0U;
	zassert_equal(plant_init(&p, &prm), -1);
	prm = base;
	prm.duty_delay = PLANT_DUTY_DELAY_MAX + 1U;
	zassert_equal(plant_init(&p, &prm), -1);
}

/* Locked rotor at theta = 0: alpha voltage step gives the RL response on d. */
ZTEST(plant, test_rl_step_locked_rotor)
{
	struct plant_params prm = base;
	struct plant p;
	const double tau = (double)LS / (double)RS;

	prm.j = J_STIFF;
	init(&p, prm);

	for (int k = 1; k <= 200; k++) {
		plant_step(&p, duty_for(RS, 0.0f));

		/* One period of delay: the voltage acts from the second step on. The
		 * reference uses the voltage actually applied (float duty rounding).
		 */
		double i_inf = (double)p.va.alpha / (double)RS;
		double t = (double)(k - 1) * (double)TS;
		double ref = i_inf * (1.0 - exp(-t / tau));
		struct plant_sample s = plant_sample(&p);

		zassert_within(p.id, ref, 1e-7, "k %d id %f ref %f", k, p.id, ref);
		zassert_within(p.iq, 0.0, 1e-12);
		zassert_within((double)s.ia, p.id, 1e-6);
		zassert_within((double)s.ib, -0.5 * p.id, 1e-6);
		zassert_within((double)s.ic, -0.5 * p.id, 1e-6);
		zassert_equal(s.vbus, VBUS);
	}
	zassert_within(p.wm, 0.0, 1e-12, "no torque from d current");
}

ZTEST(plant, test_duty_delay)
{
	struct foc_abc on = duty_for(5.0f, 0.0f);

	for (unsigned int delay = 0U; delay <= PLANT_DUTY_DELAY_MAX; delay++) {
		struct plant_params prm = base;
		struct plant p;

		prm.duty_delay = delay;
		init(&p, prm);
		plant_step(&p, on);
		for (unsigned int k = 1U; k <= delay; k++) {
			zassert_equal(p.id, 0.0, "delay %u step %u", delay, k);
			zassert_equal(p.applied.a, 0.5f);
			zassert_equal(p.va.alpha, 0.0f);
			plant_step(&p, on);
		}
		zassert_true(p.id > 0.0, "delay %u", delay);
		zassert_equal(p.applied.a, on.a);
		zassert_within(p.va.alpha, 5.0f, 1e-5f);
	}
}

ZTEST(plant, test_duty_history_order)
{
	struct plant_params prm = base;
	struct plant p;

	prm.duty_delay = PLANT_DUTY_DELAY_MAX;
	init(&p, prm);
	for (int k = 0; k < 10; k++) {
		plant_step(&p, (struct foc_abc){.a = 0.1f * (float)k, .b = 0.5f, .c = 0.5f});
		float expect = (k < (int)PLANT_DUTY_DELAY_MAX)
				       ? 0.5f
				       : 0.1f * (float)(k - (int)PLANT_DUTY_DELAY_MAX);

		zassert_equal(p.applied.a, expect, "k %d", k);
	}
}

ZTEST(plant, test_common_mode_and_clamp)
{
	struct plant p;

	init(&p, base);
	for (int k = 0; k < 20; k++) {
		plant_step(&p, (struct foc_abc){.a = 0.8f, .b = 0.8f, .c = 0.8f});
	}
	zassert_equal(p.id, 0.0);
	zassert_equal(p.iq, 0.0);

	/* Out-of-range and NaN duties clamp to [0, 1]: (1, 0, 0) gives alpha = 2/3 Vbus. */
	init(&p, base);
	plant_step(&p, (struct foc_abc){.a = 7.0f, .b = -1.0f, .c = NAN});
	plant_step(&p, (struct foc_abc){.a = 0.5f, .b = 0.5f, .c = 0.5f});
	zassert_within(p.va.alpha, 2.0f / 3.0f * VBUS, 1e-5f);
	zassert_within(p.va.beta, 0.0f, 1e-6f);
	zassert_true(isfinite(p.id) && p.id > 0.0);
}

/*
 * Rotor driven at constant speed, windings shorted (zero voltage). The
 * steady state checks the cross-coupling and back-EMF signs:
 *   0 = -R id + we L iq,   0 = -R iq - we L id - we psi
 */
ZTEST(plant, test_short_circuit_steady_state)
{
	struct plant_params prm = base;
	struct plant p;
	const double wm = 100.0, we = (double)PP * wm;
	const double r = (double)RS, x = we * (double)LS, psi = (double)PSI;
	const double den = r * r + x * x;
	const double id_ref = -x * we * psi / den;
	const double iq_ref = -r * we * psi / den;
	const struct foc_abc zero = {.a = 0.5f, .b = 0.5f, .c = 0.5f};

	prm.j = J_STIFF;
	init(&p, prm);
	p.wm = wm;

	for (int k = 1; k <= 2000; k++) {
		plant_step(&p, zero);
		zassert_true(p.theta_e >= -PLANT_PI && p.theta_e <= PLANT_PI, "k %d", k);
	}

	zassert_within(p.id, id_ref, 1e-6 * fabs(id_ref), "id %f ref %f", p.id, id_ref);
	zassert_within(p.iq, iq_ref, 1e-6 * fabs(iq_ref), "iq %f ref %f", p.iq, iq_ref);
	zassert_within(p.wm, wm, 1e-6);

	/* Angle advanced by we * t, wrapped. */
	double th_ref = remainder(we * p.t, 2.0 * PLANT_PI);

	zassert_within(remainder(p.theta_e - th_ref, 2.0 * PLANT_PI), 0.0, 1e-6, "theta %f ref %f",
		       p.theta_e, th_ref);

	/* The sample is the same current seen in the stationary frame. */
	struct plant_sample s = plant_sample(&p);
	struct foc_ab iab = foc_clarke((struct foc_abc){.a = s.ia, .b = s.ib, .c = s.ic});
	struct foc_dq idq = foc_park(iab, foc_sincos((float)p.theta_e));

	zassert_within((double)(s.ia + s.ib + s.ic), 0.0, 1e-6);
	zassert_within((double)idq.d, p.id, 1e-5);
	zassert_within((double)idq.q, p.iq, 1e-5);
}

/* Positive q current accelerates the rotor: J dw/dt = 1.5 p psi iq. */
ZTEST(plant, test_torque_accelerates)
{
	struct plant p;
	double impulse = 0.0;

	init(&p, base);
	/* At theta = 0 the q axis is beta. */
	for (int k = 0; k < 40; k++) {
		double te0 = plant_torque(&p);

		plant_step(&p, duty_for(0.0f, 3.0f));
		impulse += 0.5 * (te0 + plant_torque(&p)) * (double)TS;
	}

	zassert_true(p.iq > 0.0 && p.wm > 0.0 && p.theta_e > 0.0);
	zassert_within(plant_torque(&p), 1.5 * (double)PP * (double)PSI * p.iq, 1e-12);
	/* Trapezoidal impulse vs. momentum, 0.5 % (the integration is coarse). */
	zassert_within(p.wm * (double)base.j, impulse, 5e-3 * impulse, "Jw %g impulse %g",
		       p.wm * (double)base.j, impulse);
}

/* psi = 0: no torque, only friction and load act on the rotor. */
ZTEST(plant, test_mechanics)
{
	struct plant_params prm = base;
	struct plant p;
	const struct foc_abc zero = {.a = 0.5f, .b = 0.5f, .c = 0.5f};
	const double wm0 = 100.0, j = (double)prm.j;

	/* Viscous friction: exponential decay with time constant J / B. */
	prm.psi = 0.0f;
	prm.b = 1e-5f;
	init(&p, prm);
	p.wm = wm0;
	for (int k = 0; k < 1000; k++) {
		plant_step(&p, zero);
	}
	double ref = wm0 * exp(-(double)prm.b * p.t / j);

	zassert_within(p.wm, ref, 1e-9 * wm0, "wm %f ref %f", p.wm, ref);

	/* Constant load torque: linear deceleration (and reversal) at t_load / J. */
	prm.b = 0.0f;
	init(&p, prm);
	p.wm = wm0;
	p.t_load = 2e-2;
	for (int k = 0; k < 1000; k++) {
		plant_step(&p, zero);
	}
	ref = wm0 - p.t_load * p.t / j;
	zassert_within(p.wm, ref, 1e-9 * wm0, "wm %f ref %f", p.wm, ref);
	zassert_true(p.wm < 0.0, "the load is active, it reverses the rotor");
}

ZTEST_SUITE(plant, NULL, NULL, NULL, NULL, NULL);
```

## src/test_speed_loop.c
```c
/*
 * SPDX-License-Identifier: MIT
 *
 * Speed loop (1 kHz) over the current loop (20 kHz) with the true angle:
 * speed steps, reversal, load step, voltage-limited speed.
 */

#include <math.h>
#include <zephyr/ztest.h>

#include "sim.h"

#define BAND 0.02 /* settling band, relative */

struct speed_result {
	double peak, low; /**< Highest and lowest speed after the step. */
	double settle;    /**< Last time outside the band around the reference, s. */
};

/* Run for t seconds and record the speed excursion around s->w_ref. */
static struct speed_result run(struct sim *s, float t)
{
	struct speed_result r = {.peak = -1e30, .low = 1e30};
	double t0 = s->p.t, ref = (double)s->w_ref;

	for (unsigned int k = 0; k < sim_cycles(s, t); k++) {
		sim_cycle(s);
		r.peak = fmax(r.peak, s->p.wm);
		r.low = fmin(r.low, s->p.wm);
		if (fabs(s->p.wm - ref) > BAND * fabs(ref)) {
			r.settle = s->p.t - t0;
		}
	}
	return r;
}

static double kt(void)
{
	return (double)foc_torque_constant(sim_motor.psi, sim_motor.pole_pairs);
}

static void start(struct sim *s)
{
	sim_init(s, &sim_motor, &sim_default_cfg);
	s->speed_loop = true;
}

/*
 * 0 -> 50 rad/s (about 480 rpm). The PI zero at wc/4 costs some overshoot
 * on a reference step; the M3 ramps remove it.
 */
ZTEST(sim_speed, test_speed_step)
{
	struct sim s;
	struct speed_result r;

	start(&s);
	s.w_ref = 50.0f;
	r = run(&s, 0.2f);

	zassert_true(r.peak < 1.25 * 50.0, "peak %f", r.peak);
	zassert_true(r.settle < 0.06, "settle %f", r.settle);
	zassert_within(s.p.wm, 50.0, 1e-3);
	/* Steady state: torque balances friction only. */
	zassert_within(s.p.iq, (double)sim_motor.b * 50.0 / kt(), 1e-4, "iq %f", s.p.iq);
	zassert_within(s.p.id, 0.0, 1e-4);
	zassert_true(fabsf(s.i_ref.q) <= sim_default_cfg.i_max);
}

ZTEST(sim_speed, test_reversal)
{
	struct sim s;
	struct speed_result r;

	start(&s);
	s.w_ref = 50.0f;
	(void)run(&s, 0.2f);
	s.w_ref = -50.0f;
	r = run(&s, 0.3f);

	/* Overshoot relative to the 100 rad/s step, as in test_speed_step. */
	zassert_true(r.low > -50.0 - 0.25 * 100.0, "low %f", r.low);
	zassert_true(r.settle < 0.1, "settle %f", r.settle);
	zassert_within(s.p.wm, -50.0, 1e-3);
}

/* Load step 0.05 Nm (about 15 % of the motor's max torque) at 50 rad/s. */
ZTEST(sim_speed, test_load_step)
{
	const double t_load = 0.05;
	struct sim s;
	struct speed_result r;

	start(&s);
	s.w_ref = 50.0f;
	(void)run(&s, 0.2f);
	s.p.t_load = t_load;
	r = run(&s, 0.3f);

	zassert_true(r.low > 0.5 * 50.0, "dip to %f", r.low);
	zassert_true(r.settle < 0.06, "recovery %f", r.settle);
	zassert_within(s.p.wm, 50.0, 1e-3);
	double iq_ref = (t_load + (double)sim_motor.b * 50.0) / kt();

	zassert_within(s.p.iq, iq_ref, 1e-3 * iq_ref, "iq %f ref %f", s.p.iq, iq_ref);
}

/*
 * 120 rad/s is above what 24 V can reach: the speed stops where the
 * back-EMF uses the whole voltage circle, the speed PI saturates at i_max
 * without winding up, and a reachable reference is tracked again without
 * undershoot.
 */
ZTEST(sim_speed, test_voltage_limited_speed)
{
	const float vmax = foc_svpwm_vmax(sim_motor.vbus, sim_default_cfg.max_duty);
	const double w_lim = (double)vmax / ((double)sim_motor.pole_pairs * (double)sim_motor.psi);
	struct sim s;
	struct speed_result r;

	start(&s);
	s.w_ref = 120.0f;
	(void)run(&s, 0.3f);
	zassert_within(s.p.wm, w_lim, 0.02 * w_lim, "wm %f limit %f", s.p.wm, w_lim);
	zassert_equal(s.i_ref.q, sim_default_cfg.i_max);
	zassert_true(fabsf(s.speed.integ) <= sim_default_cfg.i_max);

	s.w_ref = 50.0f;
	r = run(&s, 0.3f);
	zassert_true(r.low > (1.0 - BAND) * 50.0, "undershoot to %f", r.low);
	zassert_true(r.settle < 0.1, "settle %f", r.settle);
	zassert_within(s.p.wm, 50.0, 1e-3);
}

ZTEST_SUITE(sim_speed, NULL, NULL, NULL, NULL, NULL);
```

## src/test_startup.c
```c
/*
 * SPDX-License-Identifier: MIT
 *
 * Full sensorless drive from standstill: align, I/f, handover, closed loop,
 * then speed and load steps and a stop, all through foc_seq and foc_cycle.
 */

#include <math.h>
#include <zephyr/ztest.h>

#include "drive.h"
#include "sim.h"

static void start(struct drive *d, double theta0, float w)
{
	drive_init(d, &sim_motor, &drive_cycle_cfg, &drive_seq_cfg);
	d->p.theta_e = theta0;
	foc_seq_start(&d->s, w);
}

/* Largest |angle error| and speed range over t seconds. */
struct span {
	double ang, lo, hi;
};

static struct span watch(struct drive *d, float t)
{
	struct span r = {.lo = 1e30, .hi = -1e30};
	unsigned int n = (unsigned int)(t / (float)d->p.ts + 0.5f);

	for (unsigned int k = 0; k < n; k++) {
		drive_cycle(d);
		zassert_true(d->pwm, "PWM off at t %f, faults %x", d->p.t, d->st.faults);
		r.ang = fmax(r.ang, fabs(drive_angle_err(d)));
		r.lo = fmin(r.lo, d->p.wm);
		r.hi = fmax(r.hi, d->p.wm);
	}
	return r;
}

/* Align time plus the I/f ramp to the handover speed. */
static double t_handover(void)
{
	return (double)drive_seq_cfg.t_align +
	       (double)(drive_seq_cfg.w_handover / drive_seq_cfg.accel_start);
}

/* Standstill to 50 rad/s from any rotor angle, both directions. */
ZTEST(sim_startup, test_start_any_angle)
{
	const double th0[] = {0.0, 1.0, 2.0, 3.0, PLANT_PI, -1.5, -2.5};
	const float ws[] = {50.0f, -50.0f};

	for (size_t w = 0; w < ARRAY_SIZE(ws); w++) {
		for (size_t n = 0; n < ARRAY_SIZE(th0); n++) {
			struct drive d;
			double t_run;
			struct span r;

			start(&d, th0[n], ws[w]);
			t_run = drive_until(&d, FOC_STATE_RUN, 0.3f);
			zassert_within(t_run, t_handover(), 3e-3, "th0 %f w %f: RUN at %f", th0[n],
				       (double)ws[w], t_run);
			/* Rotor follows the forced angle in the start direction. */
			zassert_true(d.p.wm * (double)ws[w] > 0.0, "th0 %f: wm %f", th0[n], d.p.wm);
			r = watch(&d, 0.2f);
			zassert_true(r.ang < 0.05, "th0 %f w %f: angle %e", th0[n], (double)ws[w],
				     r.ang);
			zassert_true(fabs(r.hi) < 1.05 * 50.0 && fabs(r.lo) < 1.05 * 50.0,
				     "th0 %f: overshoot %f %f", th0[n], r.lo, r.hi);
			r = watch(&d, 0.1f);
			zassert_within(d.p.wm, (double)ws[w], 1e-3, "th0 %f: wm %f", th0[n],
				       d.p.wm);
			zassert_true(r.ang < 1e-3, "th0 %f: steady angle %e", th0[n], r.ang);
		}
	}
}

/*
 * Against 0.05 Nm of Coulomb friction (about 30 % of the torque i_start
 * makes): the rotor lags the forced angle, and the preload carries the
 * torque over the handover, so the speed does not dip.
 */
ZTEST(sim_startup, test_start_loaded)
{
	const double load = 0.05;
	const double kt = (double)foc_torque_constant(sim_motor.psi, sim_motor.pole_pairs);
	struct drive d;
	struct span r;

	start(&d, 0.5, 50.0f);
	d.p.t_fric = load;
	zassert_true(drive_until(&d, FOC_STATE_IF, 0.2f) > 0.0);
	/* Past the PLL release at w_handover / 2, before the handover. */
	drive_run(&d, 0.08f);
	zassert_equal(d.s.state, FOC_STATE_IF);
	/* Lag from Kt i_start sin(delta) = load (+ acceleration), on the PLL. */
	double delta = asin(load / (kt * (double)drive_seq_cfg.i_start));

	zassert_within((double)d.st.delta, delta, 0.1, "delta %f expected %f", (double)d.st.delta,
		       delta);
	zassert_true(drive_until(&d, FOC_STATE_RUN, 0.1f) > 0.0);
	zassert_within((double)d.s.speed.integ, load / kt, 0.15 * load / kt, "preload %f",
		       (double)d.s.speed.integ);
	r = watch(&d, 0.02f);
	zassert_true(r.lo > 0.9 * (double)drive_seq_cfg.w_handover, "dip to %f", r.lo);
	zassert_true(r.ang < 0.1, "angle %e", r.ang);
	r = watch(&d, 0.3f);
	zassert_within(d.p.wm, 50.0, 1e-3);
	zassert_within(d.p.iq, load / kt, 1e-2 * load / kt);
}

/* Speed steps, a load step and a target below the handover speed. */
ZTEST(sim_startup, test_speed_and_load_steps)
{
	struct drive d;
	struct span r;

	start(&d, 0.0, 40.0f);
	(void)watch(&d, 0.4f);
	zassert_within(d.p.wm, 40.0, 1e-3);

	foc_seq_set_speed(&d.s, 90.0f);
	r = watch(&d, 0.3f);
	zassert_true(r.hi < 1.03 * 90.0, "overshoot %f", r.hi);
	zassert_true(r.ang < 0.05, "up: angle %e", r.ang);
	zassert_within(d.p.wm, 90.0, 1e-3);

	d.p.t_load = 0.05;
	r = watch(&d, 0.3f);
	zassert_true(r.lo > 0.6 * 90.0, "dip %f", r.lo);
	zassert_true(r.ang < 0.05, "load: angle %e", r.ang);
	zassert_within(d.p.wm, 90.0, 1e-3);

	/* Below the handover speed, or reversed: held at w_handover. */
	foc_seq_set_speed(&d.s, -40.0f);
	r = watch(&d, 0.4f);
	zassert_true(r.ang < 0.05, "down: angle %e", r.ang);
	zassert_within(d.p.wm, (double)drive_seq_cfg.w_handover, 1e-3, "wm %f", d.p.wm);
	zassert_true(r.lo > 0.8 * (double)drive_seq_cfg.w_handover, "low %f", r.lo);
}

/* Stop: PWM off, the rotor coasts to rest; a restart then works again. */
ZTEST(sim_startup, test_stop_and_restart)
{
	struct drive d;

	start(&d, 0.0, 50.0f);
	drive_run(&d, 0.4f);
	zassert_within(d.p.wm, 50.0, 1e-3);
	d.p.t_fric = 0.02;
	foc_seq_stop(&d.s);
	drive_run(&d, 0.002f);
	zassert_equal(d.s.state, FOC_STATE_STOP);
	zassert_equal(d.st.state, FOC_STATE_STOP);
	zassert_false(d.pwm);
	zassert_equal(d.p.id, 0.0);
	zassert_equal(d.p.iq, 0.0);
	drive_run(&d, 0.3f);
	zassert_true(fabs(d.p.wm) < 0.1, "still turning at %f", d.p.wm);
	zassert_equal(d.st.state, FOC_STATE_STOP);
	foc_seq_start(&d.s, -40.0f);
	zassert_true(drive_until(&d, FOC_STATE_RUN, 0.3f) > 0.0);
	(void)watch(&d, 0.3f);
	zassert_within(d.p.wm, -40.0, 1e-3);
}

/*
 * Observer (and current gains) with Rs or Ls 30 % off, against friction.
 * In I/f a wrong Rs turns the resistive drop of the d current into a false
 * EMF along d, so the PLL is up to ~0.6 rad off at the handover (Rs x0.7).
 * The switch then costs a speed bump, but the loop locks within 50 ms.
 */
ZTEST(sim_startup, test_start_parameter_error)
{
	const float sc[] = {0.7f, 1.3f};

	for (size_t i = 0; i < ARRAY_SIZE(sc); i++) {
		for (size_t k = 0; k < 2U; k++) {
			struct foc_cycle_cfg cc = drive_cycle_cfg;
			struct drive d;
			struct span hand, r;

			if (k == 0U) {
				cc.rs *= sc[i];
			} else {
				cc.ls *= sc[i];
			}
			drive_init(&d, &sim_motor, &cc, &drive_seq_cfg);
			d.p.t_fric = 0.03;
			foc_seq_start(&d.s, 50.0f);
			zassert_true(drive_until(&d, FOC_STATE_RUN, 0.3f) > 0.0);
			hand = watch(&d, 0.05f);
			r = watch(&d, 0.35f);
			printk("x%.1f %s: handover angle %.3f speed %.1f..%.1f\n", (double)sc[i],
			       k ? "ls" : "rs", hand.ang, hand.lo, hand.hi);
			zassert_true(hand.ang < 0.8 && hand.hi < 60.0, "x%f %s: handover %e %f",
				     (double)sc[i], k ? "ls" : "rs", hand.ang, hand.hi);
			zassert_true(r.ang < 0.03, "x%f %s: angle %e", (double)sc[i],
				     k ? "ls" : "rs", r.ang);
			zassert_within(d.p.wm, 50.0, 1e-2, "x%f: wm %f", (double)sc[i], d.p.wm);
		}
	}
}

ZTEST_SUITE(sim_startup, NULL, NULL, NULL, NULL, NULL);
```
