## CMakeLists.txt
```
# SPDX-License-Identifier: MIT

cmake_minimum_required(VERSION 3.20.0)
find_package(Zephyr REQUIRED HINTS $ENV{ZEPHYR_BASE})
project(pmsm_motor_test)

FILE(GLOB app_sources src/*.c)
target_sources(app PRIVATE ${app_sources})

# UBSan only reports and continues by default; make every finding abort the test.
if(CONFIG_UBSAN)
  zephyr_compile_options(-fno-sanitize-recover=all)
endif()
```

## prj.conf
```kconfig
CONFIG_ZTEST=y
# The motor thread runs every 1 ms; native_sim defaults to 100 ticks/s.
CONFIG_SYS_CLOCK_TICKS_PER_SEC=10000
# Shell commands, run through the dummy backend (src/test_shell.c).
CONFIG_SHELL=y
CONFIG_SHELL_BACKEND_SERIAL=n
CONFIG_SHELL_BACKEND_DUMMY=y
CONFIG_SHELL_BACKEND_DUMMY_BUF_SIZE=1024
```

## app.overlay
```dts
/* SPDX-License-Identifier: MIT */

/ {
	/* FIT1036 estimates (docs/HARDWARE.md), 24 V, 20 kHz, on its kernel timer. */
	ps: power-stage {
		compatible = "pmsm,sim-power-stage";
		resistance-micro-ohms = <3600000>;
		inductance-nano-henries = <1500000>;
		flux-linkage-micro-webers = <11000>;
		pole-pairs = <11>;
		inertia-nano-kg-m2 = <6000>;
	};

	/* Controller model = the simulated motor; settings as tests/sim. */
	motor0: motor {
		compatible = "pmsm,motor";
		power-stage = <&ps>;
		resistance-micro-ohms = <3600000>;
		inductance-nano-henries = <1500000>;
		flux-linkage-micro-webers = <11000>;
		pole-pairs = <11>;
		inertia-nano-kg-m2 = <6000>;
		max-current-milliamps = <1400>;
		start-current-milliamps = <1000>;
		trip-current-milliamps = <3000>;
		vbus-min-millivolts = <10000>;
		vbus-max-millivolts = <30000>;
		max-speed-rpm = <950>;
	};
};
```

## src/common.c
```c
/*
 * SPDX-License-Identifier: MIT
 *
 * Helpers shared by the motor test suites.
 */

#include <zephyr/ztest.h>
#include <pmsm/power_stage_sim.h>

#include "common.h"

const struct device *const motor = DEVICE_DT_GET(DT_NODELABEL(motor0));
const struct device *const ps = DEVICE_DT_GET(DT_NODELABEL(ps));

/* As app.overlay. */
static const struct plant_params plant_prm = {
	.rs = 3.6f,
	.ls = 1.5e-3f,
	.psi = 0.011f,
	.pole_pairs = 11U,
	.j = 6e-6f,
	.b = 0.0f,
	.vbus = 24.0f,
	.ts = 50e-6f,
	.duty_delay = 1U,
	.substeps = 8U,
};

struct motor_status status(void)
{
	struct motor_status st;

	zassert_ok(motor_get_status(motor, &st));
	return st;
}

bool wait_state(enum foc_state state, unsigned int ms)
{
	for (unsigned int t = 0; t <= ms; t++) {
		if (status().state == state) {
			return true;
		}
		k_msleep(1);
	}
	return false;
}

struct plant plant_get(void)
{
	k_spinlock_key_t key;
	struct plant p = *power_stage_sim_lock(ps, &key);

	power_stage_sim_unlock(ps, key);
	return p;
}

void plant_reset(void)
{
	k_spinlock_key_t key;
	int ret = plant_init(power_stage_sim_lock(ps, &key), &plant_prm);

	power_stage_sim_unlock(ps, key);
	zassert_ok(ret);
}

void motor_test_before(void *f)
{
	ARG_UNUSED(f);
	zassert_true(device_is_ready(motor));
	zassert_ok(motor_stop(motor));
	zassert_true(wait_state(FOC_STATE_STOP, 5));
	k_msleep(2); /* Controller in STOP too. */
	power_stage_sim_brk(ps, false);
	power_stage_sim_set_offset(ps, 0.0f, 0.0f, 0.0f);
	plant_reset();
}
```

## src/common.h
```c
/*
 * SPDX-License-Identifier: MIT
 *
 * Helpers shared by the motor test suites.
 */

#ifndef TESTS_MOTOR_COMMON_H_
#define TESTS_MOTOR_COMMON_H_

#include <stdbool.h>
#include <zephyr/device.h>
#include <pmsm/foc.h>
#include <pmsm/motor.h>
#include <pmsm/plant.h>

extern const struct device *const motor;
extern const struct device *const ps;

/** \brief The motor's status; asserts that the read succeeds. */
struct motor_status status(void);

/** \brief Wait up to \p ms for \p state; returns whether it was reached. */
bool wait_state(enum foc_state state, unsigned int ms);

/** \brief Copy of the simulated motor. */
struct plant plant_get(void);

/** \brief Rotor back to standstill at angle 0. */
void plant_reset(void);

/** \brief ztest before-hook: motor stopped, no break, no offsets, rotor at rest. */
void motor_test_before(void *f);

#endif /* TESTS_MOTOR_COMMON_H_ */
```

## src/test_motor.c
```c
/*
 * SPDX-License-Identifier: MIT
 *
 * Motor device on the timer-driven sim power stage: the ISR/thread split,
 * the cmd/status exchange and the API, in simulated kernel time.
 */

#include <errno.h>
#include <math.h>
#include <zephyr/ztest.h>
#include <pmsm/motor.h>
#include <pmsm/plant.h>
#include <pmsm/power_stage_sim.h>

#include "common.h"

ZTEST(motor, test_start_run_speed)
{
	zassert_ok(motor_start(motor, 50.0f));
	zassert_equal(motor_start(motor, 50.0f), -EALREADY);
	k_msleep(500);

	struct motor_status st = status();

	zassert_equal(st.state, FOC_STATE_RUN, "state %d", st.state);
	k_msleep(300);
	st = status();
	zassert_within(plant_get().wm, 50.0, 2.5, "plant %f rad/s", plant_get().wm);
	zassert_within((double)st.speed, plant_get().wm, 1.0, "estimate %f rad/s",
		       (double)st.speed);
	zassert_within((double)st.speed_target, 50.0, 1e-4);
	zassert_within((double)st.speed_ref, 50.0, 1e-4);
	zassert_within((double)st.vbus, 24.0, 1e-3);
	zassert_true(st.emf > 0.0f);
	zassert_equal(st.faults, 0U);
	zassert_equal(st.late, 0U);

	zassert_ok(motor_set_speed(motor, 80.0f));
	k_msleep(300);
	zassert_within(plant_get().wm, 80.0, 4.0, "plant %f rad/s", plant_get().wm);
}

ZTEST(motor, test_reverse)
{
	zassert_ok(motor_start(motor, -50.0f));
	k_msleep(800);
	zassert_equal(status().state, FOC_STATE_RUN);
	zassert_within(plant_get().wm, -50.0, 2.5, "plant %f rad/s", plant_get().wm);

	/* The direction is fixed at start: the other sign holds the handover speed. */
	zassert_ok(motor_set_speed(motor, 50.0f));
	zassert_true(status().speed_target < 0.0f);
}

ZTEST(motor, test_stop_restart)
{
	zassert_ok(motor_start(motor, 50.0f));
	k_msleep(600);
	zassert_ok(motor_stop(motor));
	/* The sequencer has not seen the stop yet. */
	zassert_equal(motor_start(motor, 50.0f), -EBUSY);
	zassert_true(wait_state(FOC_STATE_STOP, 2));
	k_msleep(2);

	struct plant p = plant_get();

	/* Outputs off: no current, the rotor coasts. */
	zassert_equal(status().speed, 0.0f);
	zassert_true(fabs(p.id) + fabs(p.iq) < 1e-9, "i %g %g", p.id, p.iq);
	zassert_true(p.wm > 40.0, "coasting at %f", p.wm);

	/* Restart from standstill (no flying start in v1). */
	plant_reset();
	zassert_ok(motor_start(motor, 60.0f));
	k_msleep(800);
	zassert_equal(status().state, FOC_STATE_RUN);
	zassert_within(plant_get().wm, 60.0, 3.0, "plant %f rad/s", plant_get().wm);
}

ZTEST(motor, test_break_fault)
{
	zassert_ok(motor_start(motor, 50.0f));
	k_msleep(600);
	zassert_equal(status().state, FOC_STATE_RUN);

	power_stage_sim_brk(ps, true);
	power_stage_sim_brk(ps, false);
	zassert_true(wait_state(FOC_STATE_FAULT, 3));
	zassert_equal(status().faults, FOC_FAULT_EXT);
	zassert_equal(motor_start(motor, 50.0f), -EIO);

	zassert_ok(motor_stop(motor));
	zassert_true(wait_state(FOC_STATE_STOP, 2));
	zassert_equal(status().faults, 0U);
	k_msleep(2);

	plant_reset();
	zassert_ok(motor_start(motor, 50.0f));
	k_msleep(800);
	zassert_equal(status().state, FOC_STATE_RUN);
	zassert_within(plant_get().wm, 50.0, 2.5);
}

/* Break input held active at start: enable fails, the controller faults at once. */
ZTEST(motor, test_break_held)
{
	power_stage_sim_brk(ps, true);
	zassert_ok(motor_start(motor, 50.0f));
	zassert_true(wait_state(FOC_STATE_FAULT, 5));
	zassert_equal(status().faults, FOC_FAULT_EXT);
	power_stage_sim_brk(ps, false);
}

ZTEST(motor, test_offsets)
{
	/* Calibrated away at start. */
	power_stage_sim_set_offset(ps, 0.2f, -0.1f, 0.05f);
	zassert_ok(motor_start(motor, 50.0f));
	k_msleep(800);
	zassert_equal(status().state, FOC_STATE_RUN);
	zassert_within(plant_get().wm, 50.0, 2.5);
	zassert_ok(motor_stop(motor));
	zassert_true(wait_state(FOC_STATE_STOP, 2));
	k_msleep(2);

	/* Beyond what the sensing can have: refused. */
	power_stage_sim_set_offset(ps, 2.0f, 0.0f, 0.0f);
	zassert_equal(motor_start(motor, 50.0f), -ERANGE);
	k_msleep(5);
	zassert_equal(status().state, FOC_STATE_STOP);
}

ZTEST(motor, test_bad_args)
{
	zassert_equal(motor_start(motor, NAN), -EINVAL);
	zassert_equal(motor_start(motor, INFINITY), -EINVAL);
	zassert_equal(motor_set_speed(motor, NAN), -EINVAL);
	zassert_equal(motor_set_speed(motor, -INFINITY), -EINVAL);
	k_msleep(5);
	zassert_equal(status().state, FOC_STATE_STOP);
}

ZTEST_SUITE(motor, NULL, NULL, motor_test_before, NULL, NULL);
```

## src/test_shell.c
```c
/*
 * SPDX-License-Identifier: MIT
 *
 * motor shell commands through the dummy shell backend, checked against
 * the motor API and the simulated plant.
 */

#include <errno.h>
#include <string.h>
#include <zephyr/shell/shell.h>
#include <zephyr/shell/shell_dummy.h>
#include <zephyr/ztest.h>
#include <pmsm/motor.h>
#include <pmsm/power_stage_sim.h>

#include "common.h"

#define RPM (6.28318530718 / 60.0)

static const char *out;

/* Run \p cmd; its output is in out afterwards. */
static int run(const char *cmd)
{
	const struct shell *sh = shell_backend_dummy_get_ptr();
	size_t len;

	shell_backend_dummy_clear_output(sh);
	int ret = shell_execute_cmd(sh, cmd);

	out = shell_backend_dummy_get_output(sh, &len);
	return ret;
}

static void zassert_out(const char *s)
{
	zassert_not_null(strstr(out, s), "'%s' not in:\n%s", s, out);
}

static void *setup(void)
{
	const struct shell *sh = shell_backend_dummy_get_ptr();

	/* The shell thread initialises the backend. */
	for (int t = 0; t < 1000 && sh->ctx->state != SHELL_STATE_ACTIVE; t++) {
		k_msleep(1);
	}
	zassert_equal(sh->ctx->state, SHELL_STATE_ACTIVE);
	return NULL;
}

ZTEST(motor_shell, test_status_stop)
{
	zassert_ok(run("motor status"));
	zassert_out("motor: stop");
	/* ref and target keep their last values in STOP. */
	zassert_out("speed   0.0 rpm (ref ");
	zassert_out("vbus    24.00 V");
	zassert_out("late    0");
	zassert_is_null(strstr(out, "faults"));
}

ZTEST(motor_shell, test_start_speed_stop)
{
	zassert_ok(run("motor start 500"));
	zassert_equal(run("motor start 500"), -EALREADY);
	zassert_out("already running");
	k_msleep(800);

	struct motor_status st = status();

	zassert_equal(st.state, FOC_STATE_RUN, "state %d", st.state);
	zassert_within((double)st.speed_target, 500.0 * RPM, 1e-3);
	zassert_within(plant_get().wm, 500.0 * RPM, 2.5, "plant %f rad/s", plant_get().wm);

	zassert_ok(run("motor status"));
	zassert_out("motor: run");
	zassert_out("(ref 500.0, target 500.0)");

	zassert_ok(run("motor speed 700"));
	k_msleep(300);
	zassert_within((double)status().speed_target, 700.0 * RPM, 1e-3);
	zassert_within(plant_get().wm, 700.0 * RPM, 3.5, "plant %f rad/s", plant_get().wm);

	zassert_ok(run("motor stop"));
	zassert_equal(run("motor start 500"), -EBUSY);
	zassert_out("still stopping");
	zassert_true(wait_state(FOC_STATE_STOP, 2));
	zassert_ok(run("motor status"));
	zassert_out("motor: stop");
}

ZTEST(motor_shell, test_reverse_named)
{
	zassert_ok(run("motor start -400 motor"));
	k_msleep(800);
	zassert_equal(status().state, FOC_STATE_RUN);
	zassert_within(plant_get().wm, -400.0 * RPM, 2.0, "plant %f rad/s", plant_get().wm);
	zassert_ok(run("motor status motor"));
	zassert_out("target -400.0)");
	zassert_ok(run("motor stop motor"));
	zassert_true(wait_state(FOC_STATE_STOP, 2));
}

ZTEST(motor_shell, test_fault)
{
	zassert_ok(run("motor start 500"));
	k_msleep(600);
	power_stage_sim_brk(ps, true);
	power_stage_sim_brk(ps, false);
	zassert_true(wait_state(FOC_STATE_FAULT, 3));

	zassert_ok(run("motor status"));
	zassert_out("motor: fault");
	zassert_out("faults  0x8 break");
	zassert_equal(run("motor start 500"), -EIO);
	zassert_out("in fault");

	zassert_ok(run("motor stop"));
	zassert_true(wait_state(FOC_STATE_STOP, 2));
	zassert_ok(run("motor status"));
	zassert_is_null(strstr(out, "faults"));
}

ZTEST(motor_shell, test_offset_refused)
{
	power_stage_sim_set_offset(ps, 2.0f, 0.0f, 0.0f);
	zassert_equal(run("motor start 500"), -ERANGE);
	zassert_out("offset calibration failed");
	k_msleep(5);
	zassert_equal(status().state, FOC_STATE_STOP);
}

ZTEST(motor_shell, test_bad_args)
{
	static const char *const bad[] = {
		"motor start",          /* Missing speed. */
		"motor speed",          /* Missing speed. */
		"motor start abc",      /* Not a number. */
		"motor start 500x",     /* Trailing junk. */
		"motor start 1.5",      /* Whole rpm only. */
		"motor start 1000001",  /* Out of range. */
		"motor speed -1000001", /* Out of range. */
		"motor start 500 ps",   /* Not a motor. */
		"motor status nope",    /* No such device. */
		"motor stop nope",      /* No such device. */
		"motor start 1 motor x" /* Too many arguments. */
	};

	for (size_t k = 0; k < ARRAY_SIZE(bad); k++) {
		zassert_not_equal(run(bad[k]), 0, "'%s' accepted", bad[k]);
	}
	k_msleep(5);
	zassert_equal(status().state, FOC_STATE_STOP);

	zassert_equal(run("motor start 500 ps"), -EINVAL);
	zassert_out("ps: no such motor");
	zassert_equal(run("motor start abc"), -EINVAL);
	zassert_out("abc: not a speed in rpm");
}

ZTEST_SUITE(motor_shell, NULL, setup, motor_test_before, NULL, NULL);
```
