## CMakeLists.txt
```
# SPDX-License-Identifier: MIT

cmake_minimum_required(VERSION 3.20.0)
find_package(Zephyr REQUIRED HINTS $ENV{ZEPHYR_BASE})
project(pmsm_foc_test)

FILE(GLOB app_sources src/*.c)
target_sources(app PRIVATE ${app_sources})

# UBSan only reports and continues by default; make every finding abort the test.
if(CONFIG_UBSAN)
  zephyr_compile_options(-fno-sanitize-recover=all)
endif()
```

## prj.conf
```kconfig
CONFIG_ZTEST=y
CONFIG_PMSM_FOC=y
```

## src/main.c
```c
/*
 * SPDX-License-Identifier: MIT
 */

#include <math.h>
#include <zephyr/ztest.h>
#include <pmsm/foc.h>

ZTEST(foc_util, test_clampf)
{
	zassert_equal(foc_clampf(0.5f, 0.0f, 1.0f), 0.5f);
	zassert_equal(foc_clampf(-1.0f, 0.0f, 1.0f), 0.0f);
	zassert_equal(foc_clampf(2.0f, 0.0f, 1.0f), 1.0f);
	zassert_equal(foc_clampf(1.0f, 0.0f, 1.0f), 1.0f);
	zassert_equal(foc_clampf(NAN, -1.0f, 1.0f), -1.0f);
}

ZTEST_SUITE(foc_util, NULL, NULL, NULL, NULL, NULL);
```

## src/test_current.c
```c
/*
 * SPDX-License-Identifier: MIT
 */

#include <math.h>
#include <zephyr/ztest.h>
#include <pmsm/foc.h>

#define VBUS     24.0f
#define MAX_DUTY 0.95f
#define TS       50e-6f

static const struct foc_pi_gains g = {.kp = 10.0f, .ki = 20000.0f};

static struct foc_abc zero_i(void)
{
	return (struct foc_abc){0};
}

ZTEST(foc_current, test_zero_ref_zero_voltage)
{
	struct foc_current c;
	struct foc_abc d;

	foc_current_init(&c, g, TS, MAX_DUTY, FOC_ADVANCE_PERIODS * TS);
	d = foc_current_step(&c, zero_i(), VBUS, 0.3f, 100.0f, (struct foc_dq){0});
	zassert_equal(d.a, 0.5f);
	zassert_equal(d.b, 0.5f);
	zassert_equal(d.c, 0.5f);
}

/* Measured current is reported in the rotor frame. */
ZTEST(foc_current, test_measured_park)
{
	struct foc_current c;
	const float th = 0.7f;
	struct foc_abc i = foc_inv_clarke(
		foc_inv_park((struct foc_dq){.d = 0.2f, .q = -1.1f}, foc_sincos(th)));

	foc_current_init(&c, g, TS, MAX_DUTY, 0.0f);
	(void)foc_current_step(&c, i, VBUS, th, 0.0f, (struct foc_dq){0});
	zassert_within(c.i.d, 0.2f, 1e-5f);
	zassert_within(c.i.q, -1.1f, 1e-5f);
}

/* The applied voltage points along q, rotated by the angle advance. */
ZTEST(foc_current, test_angle_advance)
{
	struct foc_current c;
	const float th = 1.0f, w = 1000.0f, t_adv = FOC_ADVANCE_PERIODS * TS;
	struct foc_abc d;
	struct foc_ab v;

	foc_current_init(&c, g, TS, MAX_DUTY, t_adv);
	d = foc_current_step(&c, zero_i(), VBUS, th, w, (struct foc_dq){.q = 0.5f});
	v = foc_duty_to_ab(d, VBUS);

	float ang = atan2f(v.beta, v.alpha);
	float expect = th + w * t_adv + 0.5f * FOC_PI_F;

	zassert_true(c.v.q > 0.0f && c.v.d == 0.0f);
	zassert_within(foc_wrap_pi(ang - expect), 0.0f, 1e-4f, "ang %f", (double)ang);
	zassert_within(hypotf(v.alpha, v.beta), c.v.q, 1e-4f);
}

/* Large references: the voltage stays on the SVPWM circle, d first. */
ZTEST(foc_current, test_voltage_limit_d_first)
{
	struct foc_current c;
	const float vmax = foc_svpwm_vmax(VBUS, MAX_DUTY);
	struct foc_abc d;

	foc_current_init(&c, g, TS, MAX_DUTY, 0.0f);
	for (int k = 0; k < 50; k++) {
		d = foc_current_step(&c, zero_i(), VBUS, 0.0f, 0.0f,
				     (struct foc_dq){.d = 0.1f, .q = 100.0f});
		zassert_true(hypotf(c.v.d, c.v.q) <= vmax * (1.0f + 1e-6f));
		zassert_true(d.a <= MAX_DUTY && d.a >= 1.0f - MAX_DUTY);
	}
	zassert_true(c.v.d > 0.0f && c.v.d < vmax);
	zassert_within(hypotf(c.v.d, c.v.q), vmax, 1e-4f, "q takes what d leaves");

	for (int k = 0; k < 50; k++) {
		(void)foc_current_step(&c, zero_i(), VBUS, 0.0f, 0.0f,
				       (struct foc_dq){.d = 100.0f, .q = 100.0f});
	}
	zassert_within(c.v.d, vmax, 1e-5f);
	zassert_within(c.v.q, 0.0f, 1e-5f);
}

/* After saturation the integrators sit at the limit, not beyond it. */
ZTEST(foc_current, test_no_windup)
{
	struct foc_current c;
	const float vmax = foc_svpwm_vmax(VBUS, MAX_DUTY);

	foc_current_init(&c, g, TS, MAX_DUTY, 0.0f);
	for (int k = 0; k < 1000; k++) {
		(void)foc_current_step(&c, zero_i(), VBUS, 0.0f, 0.0f,
				       (struct foc_dq){.q = 100.0f});
	}
	zassert_true(c.q.integ <= vmax);
	/* Reference to 0 with the current at 0: the output drops at once. */
	(void)foc_current_step(&c, zero_i(), VBUS, 0.0f, 0.0f, (struct foc_dq){0});
	zassert_true(c.v.q <= vmax);
	foc_current_reset(&c);
	zassert_equal(c.d.integ, 0.0f);
	zassert_equal(c.q.integ, 0.0f);
}

ZTEST(foc_current, test_init_sanitizes)
{
	struct foc_current c;

	foc_current_init(&c, g, TS, NAN, NAN);
	zassert_equal(c.max_duty, 0.5f);
	zassert_equal(c.t_adv, 0.0f);
	foc_current_init(&c, g, TS, 2.0f, -1.0f);
	zassert_equal(c.max_duty, 1.0f);
	zassert_equal(c.t_adv, 0.0f);
}

ZTEST_SUITE(foc_current, NULL, NULL, NULL, NULL, NULL);
```

## src/test_cycle.c
```c
/*
 * SPDX-License-Identifier: MIT
 *
 * Per-cycle controller: state transitions, fault checks and latching,
 * forced angle and PLL hold, handover rotation of the current integrators.
 */

#include <math.h>
#include <zephyr/ztest.h>
#include <pmsm/foc.h>

static const struct foc_cycle_cfg cfg = {
	.ts = 50e-6f,
	.rs = 3.6f,
	.ls = 1.5e-3f,
	.max_duty = 0.95f,
	.t_adv = FOC_ADVANCE_PERIODS * 50e-6f,
	.delay = 1U,
	.bw_current_hz = 500.0f,
	.bw_obs_hz = 2000.0f,
	.bw_pll_hz = 150.0f,
	.w_max = 3000.0f,
	.e_min = 0.1f,
	.i_trip = 3.0f,
	.vbus_min = 10.0f,
	.vbus_max = 30.0f,
};

static const struct foc_abc i0 = {0};

static bool is_zero_voltage(struct foc_abc d)
{
	return d.a == 0.5f && d.b == 0.5f && d.c == 0.5f;
}

static struct foc_abc step(struct foc_cycle *c, enum foc_state s, struct foc_abc i, float vbus,
			   struct foc_status *st)
{
	struct foc_cmd cmd = {.state = s, .i_ref = {.d = 1.0f}, .pll_hold = 1U};

	return foc_cycle_step(c, &cmd, i, vbus, st);
}

ZTEST(foc_cycle, test_stop_is_zero_voltage)
{
	struct foc_cycle c;
	struct foc_status st;

	foc_cycle_init(&c, &cfg);
	zassert_equal(c.state, FOC_STATE_STOP);
	zassert_true(is_zero_voltage(step(&c, FOC_STATE_STOP, i0, 24.0f, &st)));
	zassert_equal(st.state, FOC_STATE_STOP);
	zassert_equal(st.seq, 1U);
	/* A FAULT command is PWM off as well, and no latched fault. */
	zassert_true(is_zero_voltage(step(&c, FOC_STATE_FAULT, i0, 24.0f, &st)));
	zassert_equal(st.state, FOC_STATE_STOP);
	zassert_equal(st.faults, 0U);
	/* A state outside the enum counts as STOP. */
	zassert_true(is_zero_voltage(step(&c, (enum foc_state)77, i0, 24.0f, &st)));
	zassert_equal(st.state, FOC_STATE_STOP);
}

/* ALIGN drives current on d at the forced angle 0: alpha voltage only. */
ZTEST(foc_cycle, test_align_drives_d)
{
	struct foc_cycle c;
	struct foc_status st;
	struct foc_abc d;

	foc_cycle_init(&c, &cfg);
	d = step(&c, FOC_STATE_ALIGN, i0, 24.0f, &st);
	zassert_equal(st.state, FOC_STATE_ALIGN);
	zassert_false(is_zero_voltage(d));

	struct foc_ab v = foc_duty_to_ab(d, 24.0f);

	zassert_true(v.alpha > 0.0f);
	zassert_within(v.beta, 0.0f, 1e-5f);
	zassert_true(st.v.d > 0.0f && st.v.q == 0.0f);
}

/* Each fault bit, from each active state; the PWM goes off in that cycle. */
ZTEST(foc_cycle, test_fault_checks)
{
	const enum foc_state states[] = {FOC_STATE_ALIGN, FOC_STATE_IF, FOC_STATE_RUN};
	const struct {
		struct foc_abc i;
		float vbus;
		unsigned int f;
	} cases[] = {
		{{3.01f, 0.0f, -3.01f}, 24.0f, FOC_FAULT_OC},
		{{0.0f, -3.01f, 0.0f}, 24.0f, FOC_FAULT_OC},
		{{0.0f, 0.0f, NAN}, 24.0f, FOC_FAULT_OC},
		{{INFINITY, 0.0f, 0.0f}, 24.0f, FOC_FAULT_OC},
		{i0, 30.01f, FOC_FAULT_OV},
		{i0, 9.99f, FOC_FAULT_UV},
		{i0, NAN, FOC_FAULT_OV | FOC_FAULT_UV},
		{{NAN, NAN, NAN}, NAN, FOC_FAULT_OC | FOC_FAULT_OV | FOC_FAULT_UV},
	};

	for (size_t s = 0; s < ARRAY_SIZE(states); s++) {
		for (size_t k = 0; k < ARRAY_SIZE(cases); k++) {
			struct foc_cycle c;
			struct foc_status st;

			foc_cycle_init(&c, &cfg);
			(void)step(&c, states[s], i0, 24.0f, &st);
			zassert_equal(st.state, states[s]);
			zassert_true(is_zero_voltage(
				step(&c, states[s], cases[k].i, cases[k].vbus, &st)));
			zassert_equal(st.state, FOC_STATE_FAULT, "state %d case %zu", states[s], k);
			zassert_equal(st.faults, cases[k].f, "case %zu: %x", k, st.faults);
		}
	}
	/* At the limits: no trip. */
	struct foc_cycle c;
	struct foc_status st;

	foc_cycle_init(&c, &cfg);
	(void)step(&c, FOC_STATE_ALIGN, (struct foc_abc){3.0f, -3.0f, 0.0f}, 30.0f, &st);
	(void)step(&c, FOC_STATE_ALIGN, i0, 10.0f, &st);
	zassert_equal(st.state, FOC_STATE_ALIGN);
}

/* FAULT holds against any command but STOP; STOP clears the bits. */
ZTEST(foc_cycle, test_fault_latches)
{
	struct foc_cycle c;
	struct foc_status st;

	foc_cycle_init(&c, &cfg);
	(void)step(&c, FOC_STATE_RUN, i0, 24.0f, &st);
	(void)step(&c, FOC_STATE_RUN, i0, 40.0f, &st);
	zassert_equal(st.state, FOC_STATE_FAULT);
	/* Condition gone, still latched; more faults add bits. */
	(void)step(&c, FOC_STATE_RUN, i0, 24.0f, &st);
	(void)step(&c, FOC_STATE_ALIGN, i0, 24.0f, &st);
	(void)step(&c, FOC_STATE_FAULT, i0, 24.0f, &st);
	zassert_equal(st.state, FOC_STATE_FAULT);
	zassert_equal(st.faults, FOC_FAULT_OV);

	zassert_true(is_zero_voltage(step(&c, FOC_STATE_STOP, i0, 24.0f, &st)));
	zassert_equal(st.state, FOC_STATE_STOP);
	zassert_equal(st.faults, 0U);
	(void)step(&c, FOC_STATE_ALIGN, i0, 24.0f, &st);
	zassert_equal(st.state, FOC_STATE_ALIGN);
}

/* External trips: taken while active, dropped while off. */
ZTEST(foc_cycle, test_external_trip)
{
	struct foc_cycle c;
	struct foc_status st;

	foc_cycle_init(&c, &cfg);
	foc_cycle_trip(&c, FOC_FAULT_EXT);
	(void)step(&c, FOC_STATE_STOP, i0, 24.0f, &st);
	(void)step(&c, FOC_STATE_ALIGN, i0, 24.0f, &st);
	zassert_equal(st.state, FOC_STATE_ALIGN);
	foc_cycle_trip(&c, FOC_FAULT_EXT);
	(void)step(&c, FOC_STATE_ALIGN, i0, 24.0f, &st);
	zassert_equal(st.state, FOC_STATE_FAULT);
	zassert_equal(st.faults, FOC_FAULT_EXT);
}

/* The current reference is clamped to the trip level. */
ZTEST(foc_cycle, test_reference_clamped)
{
	struct foc_cycle_cfg b = cfg;
	struct foc_cycle c;
	struct foc_status st;
	struct foc_cmd cmd = {.state = FOC_STATE_ALIGN, .i_ref = {.d = 100.0f, .q = -NAN}};

	b.i_trip = 1.0f; /* keeps the first PI output inside the voltage limit */
	foc_cycle_init(&c, &b);
	(void)foc_cycle_step(&c, &cmd, i0, 24.0f, &st);
	/* First PI step: (Kp + Ki ts) * err with err clamped to 1 A. */
	zassert_within(st.v.d, c.cur.d.kp + c.cur.d.ki_ts, 1e-4f);
	zassert_equal(st.v.q, 0.0f);
}

/*
 * Forced angle: integrated from w_forced; with pll_hold the PLL follows it,
 * without it the PLL runs on the observer. Leaving STOP resets it to 0.
 */
ZTEST(foc_cycle, test_forced_angle_and_hold)
{
	struct foc_cycle c;
	struct foc_status st;
	struct foc_cmd cmd = {.state = FOC_STATE_IF, .w_forced = 1000.0f, .pll_hold = 1U};

	foc_cycle_init(&c, &cfg);
	for (int k = 0; k < 20; k++) {
		(void)foc_cycle_step(&c, &cmd, i0, 24.0f, &st);
	}
	zassert_within(c.theta_f, 20.0f * 1000.0f * cfg.ts, 1e-5f);
	zassert_equal(st.theta, c.theta_f);
	zassert_equal(st.omega, 1000.0f);
	zassert_equal(st.delta, 0.0f);

	/* Released: the PLL coasts on its own (no EMF here), the forced angle goes on. */
	cmd.pll_hold = 0U;
	(void)foc_cycle_step(&c, &cmd, i0, 24.0f, &st);
	zassert_within(c.theta_f, 21.0f * 1000.0f * cfg.ts, 1e-5f);

	/* The speed is clamped to w_max. */
	cmd.w_forced = 1e9f;
	cmd.pll_hold = 1U;
	(void)foc_cycle_step(&c, &cmd, i0, 24.0f, &st);
	zassert_equal(st.omega, cfg.w_max);

	(void)step(&c, FOC_STATE_STOP, i0, 24.0f, &st);
	(void)step(&c, FOC_STATE_ALIGN, i0, 24.0f, &st);
	zassert_equal(c.theta_f, 0.0f);
}

/*
 * Handover: the voltage vector in the stationary frame is the same just
 * before and after the switch to the PLL frame. The integrators carry it;
 * a zero current error keeps the proportional part out.
 */
ZTEST(foc_cycle, test_handover_keeps_voltage)
{
	struct foc_cycle c;
	struct foc_status st;
	struct foc_cmd cmd = {.state = FOC_STATE_IF, .i_ref = {.d = 1.0f}, .pll_hold = 1U};

	foc_cycle_init(&c, &cfg);
	(void)foc_cycle_step(&c, &cmd, i0, 24.0f, &st);
	/* Integrators as after some I/f time; PLL somewhere else. */
	foc_pi_reset(&c.cur.d, 2.0f);
	foc_pi_reset(&c.cur.q, 0.5f);
	c.theta_f = 0.3f;
	foc_pll_reset(&c.pll, -0.6f, 0.0f);

	struct foc_ab before = foc_inv_park((struct foc_dq){.d = c.cur.d.integ, .q = c.cur.q.integ},
					    foc_sincos(c.theta_f));

	cmd.state = FOC_STATE_RUN;
	cmd.i_ref = (struct foc_dq){0};
	/* Zero current in, zero reference: only the integrators act. */
	(void)foc_cycle_step(&c, &cmd, i0, 24.0f, &st);
	zassert_equal(st.state, FOC_STATE_RUN);

	struct foc_ab after = foc_inv_park((struct foc_dq){.d = c.cur.d.integ, .q = c.cur.q.integ},
					   foc_sincos(-0.6f));

	zassert_within(after.alpha, before.alpha, 1e-5f);
	zassert_within(after.beta, before.beta, 1e-5f);
	/* In RUN the forced angle follows the PLL. */
	zassert_equal(st.delta, 0.0f);
}

/* Bad limits fail safe: the first active cycle trips. */
ZTEST(foc_cycle, test_bad_limits_trip)
{
	const struct {
		float i_trip, vmin, vmax;
		unsigned int f;
	} cases[] = {
		{NAN, 10.0f, 30.0f, FOC_FAULT_OC},     {-1.0f, 10.0f, 30.0f, FOC_FAULT_OC},
		{3.0f, NAN, 30.0f, FOC_FAULT_UV},      {3.0f, -1.0f, 30.0f, FOC_FAULT_UV},
		{3.0f, 10.0f, INFINITY, FOC_FAULT_OV}, {3.0f, 10.0f, 0.0f, FOC_FAULT_OV},
	};

	for (size_t k = 0; k < ARRAY_SIZE(cases); k++) {
		struct foc_cycle_cfg b = cfg;
		struct foc_cycle c;
		struct foc_status st;

		b.i_trip = cases[k].i_trip;
		b.vbus_min = cases[k].vmin;
		b.vbus_max = cases[k].vmax;
		foc_cycle_init(&c, &b);
		(void)step(&c, FOC_STATE_ALIGN, i0, 24.0f, &st);
		zassert_equal(st.state, FOC_STATE_FAULT, "case %zu", k);
		zassert_true((st.faults & cases[k].f) != 0U, "case %zu: %x", k, st.faults);
	}
}

ZTEST_SUITE(foc_cycle, NULL, NULL, NULL, NULL, NULL);
```

## src/test_gains.c
```c
/*
 * SPDX-License-Identifier: MIT
 */

#include <math.h>
#include <zephyr/ztest.h>
#include <pmsm/foc.h>

ZTEST(foc_gains, test_current_values)
{
	struct foc_pi_gains g = foc_gains_current(2.0f, 1e-3f, 1000.0f);

	zassert_within(g.kp, 2.0f * FOC_PI_F, 1e-5f);
	zassert_within(g.ki, 4000.0f * FOC_PI_F, 1e-2f);
}

ZTEST(foc_gains, test_torque_constant)
{
	zassert_within(foc_torque_constant(0.011f, 11), 0.1815f, 1e-6f);
}

/*
 * Current loop on an RL phase (exact ZOH discretisation), with the one-cycle
 * duty delay of the real system. Pole cancellation should give a first-order
 * response with time constant 1/wc.
 */
ZTEST(foc_gains, test_current_loop_rl)
{
	const float fs = 20000.0f, ts = 1.0f / fs;
	const float r = 3.6f, l = 1.5e-3f, bw = 200.0f, vlim = 12.0f;
	const float a = expf(-r * ts / l);
	const int n_tau = (int)lroundf(fs / (FOC_2PI_F * bw));
	struct foc_pi pi;
	float i = 0.0f, v_applied = 0.0f, i_peak = 0.0f, i_tau = 0.0f;

	foc_pi_init(&pi, foc_gains_current(r, l, bw), ts);
	for (int k = 0; k < 20 * n_tau; k++) {
		float v_next = foc_pi_step(&pi, 1.0f - i, -vlim, vlim);

		i = a * i + (1.0f - a) / r * v_applied;
		v_applied = v_next;
		i_peak = fmaxf(i_peak, i);
		if (k == n_tau) {
			i_tau = i;
		}
	}

	zassert_within(i_tau, 0.632f, 0.06f, "i(tau) %f", (double)i_tau);
	zassert_true(i_peak < 1.02f, "overshoot, peak %f", (double)i_peak);
	zassert_within(i, 1.0f, 1e-3f);
}

/* Speed loop on Kt/(J s) with an ideal current loop, run at 1 kHz. */
ZTEST(foc_gains, test_speed_loop_inertia)
{
	const float ts = 1e-3f, j = 6e-6f, bw = 10.0f, imax = 1.4f, ref = 50.0f;
	const float kt = foc_torque_constant(0.011f, 11);
	struct foc_pi pi;
	float w = 0.0f, w_peak = 0.0f;

	foc_pi_init(&pi, foc_gains_speed(j, kt, bw), ts);
	for (int k = 0; k < 1000; k++) {
		float iq = foc_pi_step(&pi, ref - w, -imax, imax);

		w += ts * kt / j * iq;
		w_peak = fmaxf(w_peak, w);
	}

	zassert_true(w_peak < 1.4f * ref, "overshoot, peak %f", (double)w_peak);
	zassert_within(w, ref, 0.01f * ref, "w %f", (double)w);
}

ZTEST_SUITE(foc_gains, NULL, NULL, NULL, NULL, NULL);
```

## src/test_observer.c
```c
/*
 * SPDX-License-Identifier: MIT
 *
 * Duty history and current/back-EMF observer against its own discrete model.
 */

#include <math.h>
#include <zephyr/ztest.h>
#include <pmsm/foc.h>

#define PI_D 3.14159265358979323846

#define RS  3.6
#define LS  1.5e-3
#define TS  50e-6
#define PSI 0.011
#define BW  2000.0f

static void init(struct foc_obs *o)
{
	foc_obs_init(o, (float)RS, (float)LS, (float)TS, BW, 6.0f, 48.0f);
}

ZTEST(foc_observer, test_duty_hist_delay)
{
	for (unsigned int delay = 0; delay <= FOC_DUTY_DELAY_MAX + 1U; delay++) {
		unsigned int eff = MIN(delay, FOC_DUTY_DELAY_MAX);
		struct foc_duty_hist h;

		foc_duty_hist_init(&h, delay);
		/*
		 * Duty written in cycle k is d = k; at sample k the period
		 * before ran on k - 1 - delay.
		 */
		for (int k = 0; k < 8; k++) {
			struct foc_abc d = foc_duty_hist_applied(&h);
			float expect = (k - 1 - (int)eff >= 0) ? (float)(k - 1 - (int)eff) : 0.5f;

			zassert_equal(d.a, expect, "delay %u k %d: %f", delay, k, (double)d.a);
			zassert_true(d.b == d.a && d.c == d.a);
			foc_duty_hist_push(&h, (struct foc_abc){(float)k, (float)k, (float)k});
		}
	}
}

ZTEST(foc_observer, test_coefficients)
{
	struct foc_obs o;
	double a = exp(-RS * TS / LS), b = (1.0 - a) / RS;
	double z = exp(-2.0 * PI_D * (double)BW * TS);

	init(&o);
	zassert_within((double)o.a, a, 1e-6);
	zassert_within((double)o.b, b, 1e-6 * b);

	/* Error dynamics at omega = 0: both roots at z. */
	double tr = (1.0 - (double)o.g_i) * (double)o.a + 1.0 - (double)o.g_e * (double)o.b;
	double det = (1.0 - (double)o.g_i) * (double)o.a;

	zassert_within(tr, 2.0 * z, 1e-5, "trace %f", tr);
	zassert_within(det, z * z, 1e-5, "det %f", det);

	/* R = 0: b is the limit ts / L. */
	foc_obs_init(&o, 0.0f, (float)LS, (float)TS, BW, 6.0f, 48.0f);
	zassert_equal(o.a, 1.0f);
	zassert_within((double)o.b, TS / LS, 1e-7 * TS / LS);
}

/*
 * Data from the observer's own model (rotating EMF at mid-period, current by
 * exact ZOH) in double precision: the estimates converge to float accuracy
 * from zero, in either direction of rotation and with a voltage applied.
 */
ZTEST(foc_observer, test_converges_on_model)
{
	const double ws[] = {550.0, -550.0, 1200.0, 0.0};

	for (size_t n = 0; n < ARRAY_SIZE(ws); n++) {
		const double w = ws[n], a = exp(-RS * TS / LS), b = (1.0 - a) / RS;
		double ia = 0.0, ib = 0.0, th = 0.4;
		double e_max = 0.0;
		struct foc_obs o;

		init(&o);
		for (int k = 0; k < 400; k++) {
			double va = 3.0 * cos(1e3 * k * TS), vb = -2.0;
			double tm = th + 0.5 * w * TS;
			double ea = -w * PSI * sin(tm), eb = w * PSI * cos(tm);
			struct foc_ab e;

			ia = a * ia + b * (va - ea);
			ib = a * ib + b * (vb - eb);
			th += w * TS;
			e = foc_obs_step(&o, (struct foc_ab){(float)ia, (float)ib},
					 (struct foc_ab){(float)va, (float)vb}, (float)w);
			if (k >= 300) {
				e_max = fmax(e_max, hypot((double)e.alpha + w * PSI * sin(th),
							  (double)e.beta - w * PSI * cos(th)));
				zassert_within((double)o.i.alpha, ia, 1e-5);
				zassert_within((double)o.i.beta, ib, 1e-5);
			}
		}
		zassert_true(e_max < 1e-4, "w %f: |e error| %e", w, e_max);
	}
}

/* Step response of the error from a 1 V EMF offset: 2 % after about 6 / (2 pi bw). */
ZTEST(foc_observer, test_bandwidth)
{
	struct foc_obs o;
	const float e_true = 1.0f;
	/* Locked rotor with a constant 1 V "EMF": i settles at -1/R. */
	double i = 0.0, a = exp(-RS * TS / LS), b = (1.0 - a) / RS;
	int k98 = -1;

	init(&o);
	for (int k = 0; k < 200; k++) {
		i = a * i + b * (0.0 - (double)e_true);
		(void)foc_obs_step(&o, (struct foc_ab){(float)i, 0.0f}, (struct foc_ab){0}, 0.0f);
		if (k98 < 0 && fabsf(o.e.alpha - e_true) < 0.02f * e_true) {
			k98 = k;
		}
	}
	/* Critically damped double pole: 2 % at about 5.8 time constants. */
	double t98 = (k98 + 1) * TS * 2.0 * PI_D * (double)BW;

	zassert_true(t98 > 4.5 && t98 < 7.5, "t98 %f (k %d)", t98, k98);
	zassert_within(o.e.alpha, e_true, 1e-4f);
	zassert_within(o.e.beta, 0.0f, 1e-6f);
}

/* A NaN measurement makes the observer coast on its model. */
ZTEST(foc_observer, test_nan_current_coasts)
{
	struct foc_obs o, ref;
	const struct foc_ab v = {2.0f, -1.0f};

	init(&o);
	o.e = (struct foc_ab){1.0f, 0.5f};
	o.i = (struct foc_ab){0.3f, 0.1f};
	ref = o;
	(void)foc_obs_step(&o, (struct foc_ab){NAN, NAN}, v, 500.0f);
	zassert_equal(o.err.alpha, 0.0f);
	zassert_equal(o.err.beta, 0.0f);

	/* Same as feeding the predicted current. */
	struct foc_ab i_pred = o.i;

	(void)foc_obs_step(&ref, i_pred, v, 500.0f);
	zassert_within(ref.e.alpha, o.e.alpha, 1e-6f);
	zassert_within(ref.e.beta, o.e.beta, 1e-6f);
}

ZTEST(foc_observer, test_reset)
{
	struct foc_obs o;

	init(&o);
	(void)foc_obs_step(&o, (struct foc_ab){1.0f, 1.0f}, (struct foc_ab){5.0f, 0.0f}, 100.0f);
	foc_obs_reset(&o);
	zassert_true(o.i.alpha == 0.0f && o.i.beta == 0.0f && o.e.alpha == 0.0f &&
		     o.e.beta == 0.0f && o.err.alpha == 0.0f && o.err.beta == 0.0f);
	zassert_true(o.g_e > 0.0f);
}

ZTEST_SUITE(foc_observer, NULL, NULL, NULL, NULL, NULL);
```

## src/test_pi.c
```c
/*
 * SPDX-License-Identifier: MIT
 */

#include <zephyr/ztest.h>
#include <pmsm/foc.h>

#define TOL 1e-6f

ZTEST(foc_pi, test_proportional)
{
	struct foc_pi pi;

	foc_pi_init(&pi, (struct foc_pi_gains){.kp = 2.0f, .ki = 0.0f}, 1e-3f);
	zassert_within(foc_pi_step(&pi, 0.25f, -10.0f, 10.0f), 0.5f, TOL);
	zassert_within(foc_pi_step(&pi, -1.0f, -10.0f, 10.0f), -2.0f, TOL);
	zassert_within(foc_pi_step(&pi, 100.0f, -10.0f, 10.0f), 10.0f, TOL);
}

ZTEST(foc_pi, test_integral)
{
	struct foc_pi pi;
	float u = 0.0f;

	foc_pi_init(&pi, (struct foc_pi_gains){.kp = 0.0f, .ki = 10.0f}, 0.01f);
	for (int i = 0; i < 5; i++) {
		u = foc_pi_step(&pi, 1.0f, -10.0f, 10.0f);
	}
	zassert_within(u, 0.5f, TOL);
	zassert_within(pi.integ, 0.5f, TOL);
}

ZTEST(foc_pi, test_anti_windup)
{
	struct foc_pi pi;
	float u;

	foc_pi_init(&pi, (struct foc_pi_gains){.kp = 0.1f, .ki = 100.0f}, 1e-3f);

	/* Integrate up to the limit, then stay saturated for a long time. */
	for (int i = 0; i < 1000; i++) {
		u = foc_pi_step(&pi, 5.0f, -1.0f, 1.0f);
		zassert_true(pi.integ <= 1.0f);
	}
	zassert_equal(u, 1.0f);

	/* Error reverses: the output must leave the limit at once. */
	u = foc_pi_step(&pi, -0.5f, -1.0f, 1.0f);
	zassert_true(u < 1.0f, "u %f", (double)u);
	zassert_within(u, -0.05f + pi.integ, TOL);
}

/* An integration step that overshoots the limit must still reach it. */
ZTEST(foc_pi, test_integrator_reaches_limit)
{
	struct foc_pi pi;

	foc_pi_init(&pi, (struct foc_pi_gains){.kp = 0.0f, .ki = 200.0f}, 1e-3f);
	foc_pi_reset(&pi, 0.9f);
	zassert_equal(foc_pi_step(&pi, 1.0f, -1.0f, 1.0f), 1.0f);
	zassert_equal(pi.integ, 1.0f);

	foc_pi_reset(&pi, -0.9f);
	zassert_equal(foc_pi_step(&pi, -1.0f, -1.0f, 1.0f), -1.0f);
	zassert_equal(pi.integ, -1.0f);

	/* With some kp: output lands on the limit, integrator = hi - p. */
	foc_pi_init(&pi, (struct foc_pi_gains){.kp = 0.25f, .ki = 500.0f}, 1e-3f);
	foc_pi_reset(&pi, 0.5f);
	zassert_within(foc_pi_step(&pi, 1.0f, -1.0f, 1.0f), 1.0f, 1e-6f);
	zassert_within(pi.integ, 0.75f, 1e-6f);
}

ZTEST(foc_pi, test_shrinking_limit)
{
	struct foc_pi pi;
	float u;

	foc_pi_init(&pi, (struct foc_pi_gains){.kp = 0.0f, .ki = 1.0f}, 1e-3f);
	foc_pi_reset(&pi, 0.8f);
	u = foc_pi_step(&pi, 0.0f, -0.5f, 0.5f);
	zassert_equal(u, 0.5f);
	zassert_equal(pi.integ, 0.5f);
}

ZTEST(foc_pi, test_reset_preload)
{
	struct foc_pi pi;

	foc_pi_init(&pi, (struct foc_pi_gains){.kp = 1.0f, .ki = 1.0f}, 1e-3f);
	foc_pi_reset(&pi, 0.3f);
	zassert_within(foc_pi_step(&pi, 0.0f, -1.0f, 1.0f), 0.3f, TOL);
}

ZTEST_SUITE(foc_pi, NULL, NULL, NULL, NULL, NULL);
```

## src/test_pll.c
```c
/*
 * SPDX-License-Identifier: MIT
 *
 * Back-EMF PLL on a synthetic EMF e = w psi (-sin(th), cos(th)).
 */

#include <math.h>
#include <zephyr/ztest.h>
#include <pmsm/foc.h>

#define PI_D 3.14159265358979323846

#define TS    50e-6
#define PSI   0.011
#define BW    150.0f
#define W_MAX 3000.0f

static void init(struct foc_pll *p)
{
	foc_pll_init(p, foc_gains_pll(BW), (float)TS, W_MAX, 0.1f);
}

static struct foc_ab emf(double w, double th)
{
	return (struct foc_ab){(float)(-w * PSI * sin(th)), (float)(w * PSI * cos(th))};
}

static double wrap(double x)
{
	return x - 2.0 * PI_D * round(x / (2.0 * PI_D));
}

/*
 * Run at constant speed w from preload w0; return the first cycle after
 * which the angle stays within 0.01 rad and the speed within 1 rad/s.
 */
static int lock_time(struct foc_pll *p, double w, float w0, int n)
{
	double th = 0.3;
	int lock = -1;

	init(p);
	foc_pll_reset(p, 0.0f, w0);
	for (int k = 0; k < n; k++) {
		th += w * TS;
		foc_pll_step(p, emf(w, th));
		if (fabs(wrap((double)p->theta - th)) < 0.01 && fabs((double)p->omega - w) < 1.0) {
			lock = (lock < 0) ? k : lock;
		} else {
			lock = -1;
		}
	}
	return lock;
}

ZTEST(foc_pll, test_gains)
{
	struct foc_pi_gains g = foc_gains_pll(100.0f);
	float wn = 2.0f * FOC_PI_F * 100.0f;

	zassert_within(g.kp, 2.0f * wn, 1e-3f);
	zassert_within(g.ki, wn * wn, 1.0f);
}

ZTEST(foc_pll, test_constant_speed)
{
	const double ws[] = {100.0, 550.0, -550.0, 1200.0, -1200.0};
	struct foc_pll p;

	for (size_t i = 0; i < ARRAY_SIZE(ws); i++) {
		int lock = lock_time(&p, ws[i], 0.0f, 4000);

		zassert_true(lock >= 0 && lock < 400, "w %f lock %d", ws[i], lock);
		zassert_within((double)p.omega, ws[i], 1e-3 * fabs(ws[i]));
		zassert_true(fabsf(p.err) < 1e-4f, "err %e", (double)p.err);
	}
}

/*
 * A preload with the wrong sign, or far off, still locks; the frequency
 * aid keeps it fast. Without it the wrong-sign cases take up to 1000
 * cycles at these speeds.
 */
ZTEST(foc_pll, test_acquisition)
{
	const double ws[] = {300.0, 550.0, -550.0, 1100.0};
	struct foc_pll p;

	for (size_t i = 0; i < ARRAY_SIZE(ws); i++) {
		const float w0[] = {(float)-ws[i], (float)(2.0 * ws[i]), W_MAX, -W_MAX};

		for (size_t j = 0; j < ARRAY_SIZE(w0); j++) {
			int lock = lock_time(&p, ws[i], w0[j], 4000);

			zassert_true(lock >= 0 && lock < 400, "w %f w0 %f lock %d", ws[i],
				     (double)w0[j], lock);
		}
	}
}

/* Type-2 loop: under constant acceleration alpha, sin(error) = alpha / wn^2. */
ZTEST(foc_pll, test_acceleration_error)
{
	const double alpha = 1e5, wn = 2.0 * PI_D * (double)BW;
	struct foc_pll p;
	double w = 300.0, th = 0.0;

	init(&p);
	foc_pll_reset(&p, 0.0f, (float)w);
	/* Up to 2500 rad/s (22 ms), below w_max. */
	while (w < 2500.0) {
		w += alpha * TS;
		th += w * TS;
		foc_pll_step(&p, emf(w, th));
	}
	double expect = alpha / (wn * wn);

	zassert_within((double)p.err, expect, 0.05 * expect, "err %f expect %f", (double)p.err,
		       expect);
	zassert_within(wrap(th - (double)p.theta), asin(expect), 0.05 * expect);
}

/* No EMF: no error, the estimate coasts at the preloaded speed. */
ZTEST(foc_pll, test_zero_emf_coasts)
{
	struct foc_pll p;

	init(&p);
	foc_pll_reset(&p, 1.0f, 200.0f);
	for (int k = 0; k < 100; k++) {
		foc_pll_step(&p, (struct foc_ab){0});
	}
	zassert_equal(p.err, 0.0f);
	zassert_within(p.omega, 200.0f, 1e-3f);
	zassert_within((double)p.theta, wrap(1.0 + 100 * 200.0 * TS), 1e-4);
}

/* Below e_min the loop gain falls with |e|. */
ZTEST(foc_pll, test_low_emf_gain)
{
	struct foc_pll p;

	init(&p);
	/* 90 deg ahead, |e| = e_min / 10: error is 1/10 of the normalised one. */
	foc_pll_step(&p, (struct foc_ab){-0.01f, 0.0f});
	zassert_within(p.err, 0.1f, 1e-6f);
	init(&p);
	foc_pll_step(&p, (struct foc_ab){-1.0f, 0.0f});
	zassert_within(p.err, 1.0f, 1e-6f);
}

ZTEST(foc_pll, test_reset_clamps)
{
	struct foc_pll p;

	init(&p);
	foc_pll_reset(&p, 7.0f, 1e6f);
	zassert_within((double)p.theta, wrap(7.0), 1e-5);
	zassert_equal(p.omega, W_MAX);
	zassert_equal(p.pi.integ, W_MAX);
	foc_pll_reset(&p, 0.0f, -1e6f);
	zassert_equal(p.omega, -W_MAX);
}

ZTEST_SUITE(foc_pll, NULL, NULL, NULL, NULL, NULL);
```

## src/test_seq.c
```c
/*
 * SPDX-License-Identifier: MIT
 *
 * Sequencer on a scripted status: state sequence and timing, align ramp
 * and turn, I/f ramp and PLL release, handover preload, target clamping,
 * fault latching and stop.
 */

#include <math.h>
#include <zephyr/ztest.h>
#include <pmsm/foc.h>

static const struct foc_seq_cfg cfg = {
	.ts = 1e-3f,
	.pole_pairs = 11U,
	.j = 6e-6f,
	.psi = 0.011f,
	.bw_speed_hz = 50.0f,
	.i_max = 1.4f,
	.i_start = 1.0f,
	.t_align = 0.1f,
	.accel_start = 300.0f,
	.w_handover = 30.0f,
	.accel = 500.0f,
	.w_max = 100.0f,
};

/* Status as the controller reports it once it follows the command. */
static struct foc_status follow(const struct foc_cmd *c)
{
	return (struct foc_status){.state = c->state, .omega = c->w_forced};
}

/* Step until the state changes, at most n steps; returns the steps taken. */
static int until_change(struct foc_seq *s, struct foc_status *st, int n)
{
	enum foc_state from = s->state;

	for (int k = 1; k <= n; k++) {
		*st = follow(foc_seq_step(s, st));
		if (s->state != from) {
			return k;
		}
	}
	return -1;
}

ZTEST(foc_seq, test_sequence_and_timing)
{
	struct foc_seq s;
	struct foc_status st = {0};

	foc_seq_init(&s, &cfg);
	for (int k = 0; k < 10; k++) {
		zassert_equal(foc_seq_step(&s, &st)->state, FOC_STATE_STOP);
	}
	foc_seq_start(&s, 60.0f);
	zassert_equal(until_change(&s, &st, 1), 1);
	zassert_equal(s.state, FOC_STATE_ALIGN);
	zassert_equal(s.cmd.pll_hold, 1U);
	/* 100 ms align (one step was the transition), 100 ms I/f to 30 rad/s. */
	int n = until_change(&s, &st, 200);

	zassert_true(n >= 99 && n <= 101, "align %d", n);
	zassert_equal(s.state, FOC_STATE_IF);
	n = until_change(&s, &st, 200);
	zassert_true(n >= 99 && n <= 101, "I/f %d", n);
	zassert_equal(s.state, FOC_STATE_RUN);
	zassert_equal(s.cmd.state, FOC_STATE_RUN);
	zassert_equal(s.w_ref, 30.0f);
}

/* Align: d ramps over the first half, the vector turns +90 degrees in the third quarter. */
ZTEST(foc_seq, test_align_profile)
{
	const float dirs[] = {1.0f, -1.0f};

	for (size_t i = 0; i < ARRAY_SIZE(dirs); i++) {
		struct foc_seq s;
		struct foc_status st = {0};
		float turn = 0.0f, id_max = 0.0f;

		foc_seq_init(&s, &cfg);
		foc_seq_start(&s, dirs[i] * 50.0f);
		(void)foc_seq_step(&s, &st);
		while (s.state == FOC_STATE_ALIGN) {
			const struct foc_cmd *c = foc_seq_step(&s, &st);

			if (s.state != FOC_STATE_ALIGN) {
				break;
			}
			zassert_true(c->i_ref.d >= id_max, "d current falls");
			id_max = c->i_ref.d;
			zassert_true(s.t > 0.05f || c->w_forced == 0.0f);
			turn += c->w_forced * cfg.ts;
			zassert_equal(c->i_ref.q, 0.0f);
		}
		zassert_equal(id_max, cfg.i_start);
		zassert_within(turn, dirs[i] * 0.5f * FOC_PI_F, 0.07f, "turn %f", (double)turn);
	}
}

/* I/f: forced speed ramps in the start direction, PLL released at half the handover. */
ZTEST(foc_seq, test_if_ramp_and_release)
{
	struct foc_seq s;
	struct foc_status st = {0};

	foc_seq_init(&s, &cfg);
	foc_seq_start(&s, -50.0f);
	while (s.state != FOC_STATE_IF) {
		st = follow(foc_seq_step(&s, &st));
	}
	float w_prev = 0.0f;

	while (s.state == FOC_STATE_IF) {
		const struct foc_cmd *c = foc_seq_step(&s, &st);

		if (s.state != FOC_STATE_IF) {
			break;
		}
		zassert_equal(c->i_ref.d, cfg.i_start);
		zassert_within(c->w_forced, w_prev - 300.0f * cfg.ts * 11.0f, 1e-2f);
		w_prev = c->w_forced;
		zassert_equal(c->pll_hold, (s.w_forced > -15.0f) ? 1U : 0U, "w %f",
			      (double)s.w_forced);
	}
}

/* Handover: speed PI preloaded with i_start sin(delta). */
ZTEST(foc_seq, test_handover_preload)
{
	const float deltas[] = {0.0f, 0.3f, -0.4f};

	for (size_t i = 0; i < ARRAY_SIZE(deltas); i++) {
		struct foc_seq s;
		struct foc_status st = {0};

		foc_seq_init(&s, &cfg);
		foc_seq_start(&s, 50.0f);
		while (s.state != FOC_STATE_RUN) {
			st = follow(foc_seq_step(&s, &st));
			st.delta = deltas[i];
		}
		zassert_within(s.speed.integ, sinf(deltas[i]), 1e-5f);
		zassert_within(s.cmd.i_ref.q, sinf(deltas[i]), 1e-5f);
		zassert_equal(s.cmd.i_ref.d, 0.0f);
	}
}

/* RUN: reference ramps at accel; target clamped to [w_handover, w_max] in the start direction. */
ZTEST(foc_seq, test_run_ramp_and_clamp)
{
	struct foc_seq s;
	struct foc_status st = {0};

	foc_seq_init(&s, &cfg);
	foc_seq_start(&s, 60.0f);
	while (s.state != FOC_STATE_RUN) {
		st = follow(foc_seq_step(&s, &st));
	}
	st.omega = 30.0f * 11.0f;
	(void)foc_seq_step(&s, &st);
	zassert_within(s.w_ref, 30.5f, 1e-4f);
	for (int k = 0; k < 100; k++) {
		(void)foc_seq_step(&s, &st);
	}
	zassert_equal(s.w_ref, 60.0f);
	/* Speed below the reference: positive q current. */
	zassert_true(s.cmd.i_ref.q > 0.0f && s.cmd.i_ref.q <= cfg.i_max);

	const struct {
		float w, t;
	} cases[] = {{1000.0f, 100.0f}, {-50.0f, 30.0f},    {5.0f, 30.0f},
		     {NAN, 30.0f},      {INFINITY, 100.0f}, {45.0f, 45.0f}};

	for (size_t k = 0; k < ARRAY_SIZE(cases); k++) {
		foc_seq_set_speed(&s, cases[k].w);
		zassert_equal(s.target, cases[k].t, "w %f", (double)cases[k].w);
	}
	/* Start in reverse: the target is negative. */
	foc_seq_stop(&s);
	(void)foc_seq_step(&s, &st);
	foc_seq_start(&s, -10.0f);
	zassert_equal(s.target, -30.0f);
	zassert_equal(s.dir, -1.0f);
}

/* Start is ignored unless stopped; stop works from every state. */
ZTEST(foc_seq, test_start_stop)
{
	const enum foc_state at[] = {FOC_STATE_ALIGN, FOC_STATE_IF, FOC_STATE_RUN};

	for (size_t i = 0; i < ARRAY_SIZE(at); i++) {
		struct foc_seq s;
		struct foc_status st = {0};

		foc_seq_init(&s, &cfg);
		foc_seq_start(&s, 50.0f);
		while (s.state != at[i]) {
			st = follow(foc_seq_step(&s, &st));
		}
		foc_seq_start(&s, -80.0f);
		zassert_equal(s.dir, 1.0f);
		zassert_equal(s.target, 50.0f);
		foc_seq_stop(&s);
		st = follow(foc_seq_step(&s, &st));
		zassert_equal(st.state, FOC_STATE_STOP);
		zassert_equal(s.state, FOC_STATE_STOP);
		/* A restart from STOP works at once. */
		foc_seq_start(&s, 50.0f);
		zassert_equal(foc_seq_step(&s, &st)->state, FOC_STATE_ALIGN);
	}
}

/* A FAULT status latches with its bits; only stop leaves it. */
ZTEST(foc_seq, test_fault_latches)
{
	struct foc_seq s;
	struct foc_status st = {0};

	foc_seq_init(&s, &cfg);
	foc_seq_start(&s, 50.0f);
	while (s.state != FOC_STATE_IF) {
		st = follow(foc_seq_step(&s, &st));
	}
	st = (struct foc_status){.state = FOC_STATE_FAULT, .faults = FOC_FAULT_UV};
	zassert_equal(foc_seq_step(&s, &st)->state, FOC_STATE_FAULT);
	zassert_equal(s.faults, FOC_FAULT_UV);
	/* Later bits do not overwrite the cause; the status clearing does not leave FAULT. */
	st.faults = FOC_FAULT_UV | FOC_FAULT_OC;
	(void)foc_seq_step(&s, &st);
	st = (struct foc_status){.state = FOC_STATE_STOP};
	zassert_equal(foc_seq_step(&s, &st)->state, FOC_STATE_FAULT);
	zassert_equal(s.faults, FOC_FAULT_UV);
	foc_seq_start(&s, 50.0f);
	zassert_equal(foc_seq_step(&s, &st)->state, FOC_STATE_FAULT);

	foc_seq_stop(&s);
	zassert_equal(foc_seq_step(&s, &st)->state, FOC_STATE_STOP);
	/* A stale FAULT status while stopped does not latch again. */
	st.state = FOC_STATE_FAULT;
	zassert_equal(foc_seq_step(&s, &st)->state, FOC_STATE_STOP);
	/* Start waits until the controller is off as well. */
	foc_seq_start(&s, 50.0f);
	zassert_equal(foc_seq_step(&s, &st)->state, FOC_STATE_STOP);
	zassert_equal(s.state, FOC_STATE_STOP);
	st.state = FOC_STATE_STOP;
	zassert_equal(foc_seq_step(&s, &st)->state, FOC_STATE_ALIGN);
	zassert_equal(s.faults, 0U);
}

ZTEST_SUITE(foc_seq, NULL, NULL, NULL, NULL, NULL);
```

## src/test_svpwm.c
```c
/*
 * SPDX-License-Identifier: MIT
 */

#include <math.h>
#include <zephyr/ztest.h>
#include <pmsm/foc.h>

#define VBUS     24.0f
#define MAX_DUTY 0.95f

ZTEST(foc_svpwm, test_zero_vector)
{
	struct foc_abc d = foc_svpwm((struct foc_ab){0}, VBUS, MAX_DUTY);

	zassert_equal(d.a, 0.5f);
	zassert_equal(d.b, 0.5f);
	zassert_equal(d.c, 0.5f);
}

ZTEST(foc_svpwm, test_vmax)
{
	/* max duty 1: classic linear limit Vbus / sqrt(3). */
	zassert_within(foc_svpwm_vmax(VBUS, 1.0f), VBUS / sqrtf(3.0f), 1e-5f);
	zassert_within(foc_svpwm_vmax(VBUS, 0.5f), 0.0f, 1e-6f);
}

ZTEST(foc_svpwm, test_linear_circle)
{
	float vmax = foc_svpwm_vmax(VBUS, MAX_DUTY);
	float hi_max = 0.0f;

	for (float th = -FOC_PI_F; th < FOC_PI_F; th += 0.01f) {
		struct foc_sincos sc = foc_sincos(th);
		struct foc_ab v = {.alpha = vmax * sc.cos, .beta = vmax * sc.sin};
		struct foc_abc d = foc_svpwm(v, VBUS, MAX_DUTY);
		float hi = fmaxf(fmaxf(d.a, d.b), d.c);
		float lo = fminf(fminf(d.a, d.b), d.c);
		struct foc_ab back = foc_duty_to_ab(d, VBUS);

		zassert_true(hi <= MAX_DUTY + 1e-6f, "th %f hi %f", (double)th, (double)hi);
		hi_max = fmaxf(hi_max, hi);
		zassert_within(0.5f * (hi + lo), 0.5f, 1e-6f);
		zassert_within(back.alpha, v.alpha, 1e-4f);
		zassert_within(back.beta, v.beta, 1e-4f);
	}

	/* The circle touches the limit at 30 deg + k * 60 deg. */
	zassert_within(hi_max, MAX_DUTY, 1e-4f, "hi_max %f", (double)hi_max);
}

ZTEST(foc_svpwm, test_overmodulation_clamps)
{
	float vmax = foc_svpwm_vmax(VBUS, MAX_DUTY);

	for (float th = -FOC_PI_F; th < FOC_PI_F; th += 0.05f) {
		struct foc_ab v = {.alpha = 3.0f * vmax * cosf(th), .beta = 3.0f * vmax * sinf(th)};
		struct foc_abc d = foc_svpwm(v, VBUS, MAX_DUTY);

		zassert_true(d.a >= 1.0f - MAX_DUTY && d.a <= MAX_DUTY);
		zassert_true(d.b >= 1.0f - MAX_DUTY && d.b <= MAX_DUTY);
		zassert_true(d.c >= 1.0f - MAX_DUTY && d.c <= MAX_DUTY);
	}
}

ZTEST(foc_svpwm, test_duty_to_ab_ignores_common_mode)
{
	struct foc_abc d = {.a = 0.7f, .b = 0.4f, .c = 0.5f};
	struct foc_abc e = {.a = 0.8f, .b = 0.5f, .c = 0.6f};
	struct foc_ab vd = foc_duty_to_ab(d, VBUS);
	struct foc_ab ve = foc_duty_to_ab(e, VBUS);

	/* v_a = (d_a - mean) * Vbus = (0.7 - 0.5333) * 24 = 4 V */
	zassert_within(vd.alpha, 4.0f, 1e-5f);
	zassert_within(vd.alpha, ve.alpha, 1e-5f);
	zassert_within(vd.beta, ve.beta, 1e-5f);
}

ZTEST_SUITE(foc_svpwm, NULL, NULL, NULL, NULL, NULL);
```

## src/test_transforms.c
```c
/*
 * SPDX-License-Identifier: MIT
 */

#include <math.h>
#include <zephyr/ztest.h>
#include <pmsm/foc.h>

#define TOL 1e-6f

static struct foc_abc balanced(float amp, float theta)
{
	return (struct foc_abc){
		.a = amp * cosf(theta),
		.b = amp * cosf(theta - 2.0f * FOC_PI_F / 3.0f),
		.c = amp * cosf(theta + 2.0f * FOC_PI_F / 3.0f),
	};
}

ZTEST(foc_transforms, test_clampf)
{
	zassert_equal(foc_clampf(0.5f, 0.0f, 1.0f), 0.5f);
	zassert_equal(foc_clampf(-1.0f, 0.0f, 1.0f), 0.0f);
	zassert_equal(foc_clampf(2.0f, 0.0f, 1.0f), 1.0f);
	zassert_equal(foc_clampf(1.0f, 0.0f, 1.0f), 1.0f);
	zassert_equal(foc_clampf(NAN, -1.0f, 1.0f), -1.0f);
}

ZTEST(foc_transforms, test_sincos_exact_points)
{
	struct foc_sincos sc = foc_sincos(0.0f);

	zassert_equal(sc.sin, 0.0f);
	zassert_equal(sc.cos, 1.0f);
}

ZTEST(foc_transforms, test_sincos_accuracy)
{
	double max_err = 0.0;

	for (int i = -200000; i <= 200000; i++) {
		float x = (float)i * 1e-4f; /* -20 .. 20 rad */
		struct foc_sincos sc = foc_sincos(x);

		max_err = fmax(max_err, fabs((double)sc.sin - sin((double)x)));
		max_err = fmax(max_err, fabs((double)sc.cos - cos((double)x)));
	}
	zassert_true(max_err < 2e-7, "max error %e", max_err);

	for (float x = -3000.0f; x <= 3000.0f; x += 0.37f) {
		struct foc_sincos sc = foc_sincos(x);

		max_err = fmax(max_err, fabs((double)sc.sin - sin((double)x)));
		max_err = fmax(max_err, fabs((double)sc.cos - cos((double)x)));
	}
	zassert_true(max_err < (double)TOL, "max error %e", max_err);
}

ZTEST(foc_transforms, test_wrap_pi)
{
	zassert_within(foc_wrap_pi(0.0f), 0.0f, TOL);
	zassert_within(foc_wrap_pi(3.0f), 3.0f, TOL);
	zassert_within(foc_wrap_pi(-3.0f), -3.0f, TOL);
	zassert_within(foc_wrap_pi(FOC_PI_F + 0.1f), -FOC_PI_F + 0.1f, TOL);
	zassert_within(foc_wrap_pi(-FOC_PI_F - 0.1f), FOC_PI_F - 0.1f, TOL);
	zassert_within(foc_wrap_pi(5.0f * FOC_2PI_F + 1.0f), 1.0f, 1e-5f);
}

ZTEST(foc_transforms, test_clarke_balanced)
{
	for (float th = -FOC_PI_F; th < FOC_PI_F; th += 0.1f) {
		struct foc_ab v = foc_clarke(balanced(2.0f, th));

		zassert_within(v.alpha, 2.0f * cosf(th), TOL * 4);
		zassert_within(v.beta, 2.0f * sinf(th), TOL * 4);
	}
}

ZTEST(foc_transforms, test_clarke_ignores_common_mode)
{
	struct foc_abc x = {.a = 1.5f, .b = -0.25f, .c = 0.75f};
	struct foc_abc y = {.a = x.a + 7.0f, .b = x.b + 7.0f, .c = x.c + 7.0f};
	struct foc_ab vx = foc_clarke(x);
	struct foc_ab vy = foc_clarke(y);
	struct foc_abc back = foc_inv_clarke(vx);
	float mean = (x.a + x.b + x.c) / 3.0f;

	zassert_within(vx.alpha, vy.alpha, TOL * 10);
	zassert_within(vx.beta, vy.beta, TOL * 10);
	zassert_within(back.a, x.a - mean, TOL);
	zassert_within(back.b, x.b - mean, TOL);
	zassert_within(back.c, x.c - mean, TOL);
}

ZTEST(foc_transforms, test_park_aligned)
{
	/* A vector rotating with theta is constant (A, 0) in dq. */
	for (float th = -FOC_PI_F; th < FOC_PI_F; th += 0.1f) {
		struct foc_dq dq = foc_park(foc_clarke(balanced(3.0f, th)), foc_sincos(th));

		zassert_within(dq.d, 3.0f, TOL * 10);
		zassert_within(dq.q, 0.0f, TOL * 10);
	}
}

ZTEST(foc_transforms, test_park_q_leads_d)
{
	struct foc_sincos sc = foc_sincos(0.3f);
	struct foc_ab ab = foc_inv_park((struct foc_dq){.d = 0.0f, .q = 1.0f}, sc);

	zassert_within(ab.alpha, cosf(0.3f + FOC_PI_F / 2.0f), TOL);
	zassert_within(ab.beta, sinf(0.3f + FOC_PI_F / 2.0f), TOL);
}

ZTEST(foc_transforms, test_park_round_trip)
{
	struct foc_dq in = {.d = -0.7f, .q = 1.3f};

	for (float th = -4.0f; th < 4.0f; th += 0.25f) {
		struct foc_sincos sc = foc_sincos(th);
		struct foc_dq out = foc_park(foc_inv_park(in, sc), sc);

		zassert_within(out.d, in.d, TOL);
		zassert_within(out.q, in.q, TOL);
	}
}

ZTEST(foc_transforms, test_limit_circle)
{
	struct foc_dq v;

	v = foc_limit_circle((struct foc_dq){.d = 0.3f, .q = -0.4f}, 1.0f);
	zassert_equal(v.d, 0.3f);
	zassert_equal(v.q, -0.4f);

	v = foc_limit_circle((struct foc_dq){.d = 0.6f, .q = 5.0f}, 1.0f);
	zassert_within(v.d, 0.6f, TOL);
	zassert_within(v.q, 0.8f, TOL);

	v = foc_limit_circle((struct foc_dq){.d = -2.0f, .q = 2.0f}, 1.0f);
	zassert_within(v.d, -1.0f, TOL);
	zassert_within(v.q, 0.0f, TOL);

	zassert_equal(foc_q_limit(2.0f, 1.0f), 0.0f);
}

ZTEST_SUITE(foc_transforms, NULL, NULL, NULL, NULL, NULL);
```
